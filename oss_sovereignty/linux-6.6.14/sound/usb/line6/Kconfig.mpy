## oss_sovereignty/sources/busybox-1.36.1/e2fsprogs/Config.in
```kconfig
menu "Linux Ext2 FS Progs"

config CHATTR
	bool "chattr (3.8 kb)"
	default y
	help
	chattr changes the file attributes on a second extended file system.
config FSCK
	bool "fsck (7.4 kb)"
	default y
	help
	fsck is used to check and optionally repair one or more filesystems.
	In actuality, fsck is simply a front-end for the various file system
	checkers (fsck.fstype) available under Linux.
config LSATTR
	bool "lsattr (5.5 kb)"
	default y
	help
	lsattr lists the file attributes on a second extended file system.
config TUNE2FS
	bool "tune2fs (4.4 kb)"
	default n  
	help
	tune2fs allows the system administrator to adjust various tunable
	filesystem parameters on Linux ext2/ext3 filesystems.


































endmenu
```

## oss_sovereignty/sources/sys_09_Anvil/source/ports/zephyr/boards/frdm_k64f.conf
```kconfig
CONFIG_NET_L2_ETHERNET=y


CONFIG_I2C=y
CONFIG_SPI=y


CONFIG_FXOS8700=y
CONFIG_FXOS8700_MODE_HYBRID=y
CONFIG_FXOS8700_TEMP=y


CONFIG_FLASH=y
CONFIG_FLASH_MAP=y
CONFIG_MPU_ALLOW_FLASH_WRITE=y
```
