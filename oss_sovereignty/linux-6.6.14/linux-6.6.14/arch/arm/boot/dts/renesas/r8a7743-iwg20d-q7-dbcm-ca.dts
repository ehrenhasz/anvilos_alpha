/dts-v1/;
#include "r8a7743-iwg20m.dtsi"
#include "iwg20d-q7-common.dtsi"
#include "iwg20d-q7-dbcm-ca.dtsi"
/ {
	model = "iW-RainboW-G20D-Q7 RZ/G1M based plus camera daughter board";
	compatible = "iwave,g20d", "iwave,g20m", "renesas,r8a7743";
};
&pciec {
	status = "okay";
};
