/dts-v1/;
#include "mstar-infinity2m-ssd202d.dtsi"
/ {
	model = "Miyoo Mini";
	compatible = "miyoo,miyoo-mini", "mstar,infinity2m";
	aliases {
		serial0 = &pm_uart;
	};
	chosen {
		stdout-path = "serial0:115200n8";
	};
};
&pm_uart {
	status = "okay";
};
