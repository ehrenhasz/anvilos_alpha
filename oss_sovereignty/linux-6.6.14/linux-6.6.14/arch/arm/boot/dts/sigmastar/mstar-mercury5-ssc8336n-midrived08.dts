/dts-v1/;
#include "mstar-mercury5-ssc8336n.dtsi"
/ {
	model = "70mai Midrive D08";
	compatible = "70mai,midrived08", "mstar,mercury5";
	aliases {
		serial0 = &pm_uart;
	};
	chosen {
		stdout-path = "serial0:115200n8";
	};
};
&pm_uart {
	status = "okay";
};
