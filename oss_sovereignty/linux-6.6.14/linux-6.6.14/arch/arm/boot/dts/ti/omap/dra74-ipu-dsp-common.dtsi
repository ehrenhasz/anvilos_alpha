#include "dra7-ipu-dsp-common.dtsi"
&mailbox6 {
	mbox_dsp2_ipc3x: mbox-dsp2-ipc3x {
		status = "okay";
	};
};
&dsp2 {
	mboxes = <&mailbox6 &mbox_dsp2_ipc3x>;
	ti,timers = <&timer6>;
	ti,watchdog-timers = <&timer13>;
};
