/dts-v1/;
#include "omap3-overo.dtsi"
#include "omap3-overo-alto35-common.dtsi"
/ {
	model = "OMAP35xx Gumstix Overo on Alto35";
	compatible = "gumstix,omap3-overo-alto35", "gumstix,omap3-overo", "ti,omap3430", "ti,omap3";
};
