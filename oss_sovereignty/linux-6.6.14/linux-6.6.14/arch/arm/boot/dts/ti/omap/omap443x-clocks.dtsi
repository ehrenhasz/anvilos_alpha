&prm_clocks {
	bandgap_fclk: bandgap_fclk@1888 {
		#clock-cells = <0>;
		compatible = "ti,gate-clock";
		clock-output-names = "bandgap_fclk";
		clocks = <&sys_32k_ck>;
		ti,bit-shift = <8>;
		reg = <0x1888>;
	};
};
