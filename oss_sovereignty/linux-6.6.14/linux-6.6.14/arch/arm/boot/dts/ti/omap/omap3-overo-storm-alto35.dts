/dts-v1/;
#include "omap3-overo-storm.dtsi"
#include "omap3-overo-alto35-common.dtsi"
/ {
	model = "OMAP36xx/AM37xx/DM37xx Gumstix Overo on Alto35";
	compatible = "gumstix,omap3-overo-alto35", "gumstix,omap3-overo", "ti,omap3630", "ti,omap3";
};
