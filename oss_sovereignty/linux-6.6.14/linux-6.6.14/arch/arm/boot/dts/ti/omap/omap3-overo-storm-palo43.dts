/dts-v1/;
#include "omap3-overo-storm.dtsi"
#include "omap3-overo-palo43-common.dtsi"
/ {
	model = "OMAP36xx/AM37xx/DM37xx Gumstix Overo on Palo43";
	compatible = "gumstix,omap3-overo-palo43", "gumstix,omap3-overo", "ti,omap3630", "ti,omap3";
};
&omap3_pmx_core2 {
	led_pins: led-pins {
		pinctrl-single,pins = <
			OMAP3630_CORE2_IOPAD(0x25ea, PIN_OUTPUT | MUX_MODE4)	 
			OMAP3630_CORE2_IOPAD(0x25ec, PIN_OUTPUT | MUX_MODE4)	 
		>;
	};
	button_pins: button-pins {
		pinctrl-single,pins = <
			OMAP3630_CORE2_IOPAD(0x25ee, PIN_INPUT | MUX_MODE4)	 
			OMAP3630_CORE2_IOPAD(0x25dc, PIN_INPUT | MUX_MODE4)	 
		>;
	};
};
