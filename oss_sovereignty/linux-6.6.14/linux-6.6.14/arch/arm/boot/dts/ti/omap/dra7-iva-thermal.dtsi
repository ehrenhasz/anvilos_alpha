#include <dt-bindings/thermal/thermal.h>
iva_thermal: iva_thermal {
	polling-delay-passive = <250>;  
	polling-delay = <500>;  
	thermal-sensors = <&bandgap     4>;
	trips {
		iva_crit: iva_crit {
			temperature = <125000>;  
			hysteresis = <2000>;  
			type = "critical";
		};
	};
};
