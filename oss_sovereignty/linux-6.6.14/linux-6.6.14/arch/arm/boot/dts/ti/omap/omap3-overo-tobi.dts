/dts-v1/;
#include "omap3-overo.dtsi"
#include "omap3-overo-tobi-common.dtsi"
/ {
	model = "OMAP35xx Gumstix Overo on Tobi";
	compatible = "gumstix,omap3-overo-tobi", "gumstix,omap3-overo", "ti,omap3430", "ti,omap3";
};
