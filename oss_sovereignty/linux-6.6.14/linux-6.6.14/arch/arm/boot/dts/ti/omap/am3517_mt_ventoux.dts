/dts-v1/;
#include "omap34xx.dtsi"
/ {
	model = "TeeJet Mt.Ventoux";
	compatible = "teejet,mt_ventoux", "ti,am3517", "ti,omap3";
	memory@80000000 {
		device_type = "memory";
		reg = <0x80000000 0x10000000>;  
	};
	soc {
		iva {
			status = "disabled";
		};
	};
};
