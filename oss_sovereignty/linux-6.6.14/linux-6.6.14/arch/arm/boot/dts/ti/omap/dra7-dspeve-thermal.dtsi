#include <dt-bindings/thermal/thermal.h>
dspeve_thermal: dspeve_thermal {
	polling-delay-passive = <250>;  
	polling-delay = <500>;  
	thermal-sensors = <&bandgap     3>;
	trips {
		dspeve_crit: dspeve_crit {
			temperature = <125000>;  
			hysteresis = <2000>;  
			type = "critical";
		};
	};
};
