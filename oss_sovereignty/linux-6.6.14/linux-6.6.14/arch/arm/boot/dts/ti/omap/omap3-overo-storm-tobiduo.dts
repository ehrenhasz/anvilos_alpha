/dts-v1/;
#include "omap3-overo-storm.dtsi"
#include "omap3-overo-tobiduo-common.dtsi"
/ {
	model = "OMAP36xx/AM37xx/DM37xx Gumstix Overo on TobiDuo";
	compatible = "gumstix,omap3-overo-tobiduo", "gumstix,omap3-overo", "ti,omap3630", "ti,omap3";
};
