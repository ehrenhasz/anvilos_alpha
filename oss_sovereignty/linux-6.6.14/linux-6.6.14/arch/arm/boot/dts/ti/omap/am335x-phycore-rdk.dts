/dts-v1/;
#include "am335x-phycore-som.dtsi"
#include "am335x-pcm-953.dtsi"
&gpmc {
	status = "okay";
};
&i2c_eeprom {
	status = "okay";
};
&i2c_rtc {
	status = "okay";
};
&serial_flash {
	status = "okay";
};
