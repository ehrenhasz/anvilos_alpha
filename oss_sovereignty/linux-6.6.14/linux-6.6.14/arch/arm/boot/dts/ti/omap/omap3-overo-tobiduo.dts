/dts-v1/;
#include "omap3-overo.dtsi"
#include "omap3-overo-tobiduo-common.dtsi"
/ {
	model = "OMAP35xx Gumstix Overo on TobiDuo";
	compatible = "gumstix,omap3-overo-tobiduo", "gumstix,omap3-overo", "ti,omap3430", "ti,omap3";
};
