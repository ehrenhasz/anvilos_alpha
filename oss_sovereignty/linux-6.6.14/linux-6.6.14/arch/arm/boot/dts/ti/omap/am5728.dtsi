#include "dra74x.dtsi"
#include "am57-pruss.dtsi"
/ {
	compatible = "ti,am5728", "ti,dra7";
};
&usb3_tm {
	status = "disabled";
};
&usb4_tm {
	status = "disabled";
};
&atl_tm {
	status = "disabled";
};
