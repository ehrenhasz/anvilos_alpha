#include <dt-bindings/thermal/thermal.h>
core_thermal: core_thermal {
	polling-delay-passive = <250>;  
	polling-delay = <500>;  
	thermal-sensors = <&bandgap     2>;
	trips {
		core_crit: core_crit {
			temperature = <125000>;  
			hysteresis = <2000>;  
			type = "critical";
		};
	};
};
