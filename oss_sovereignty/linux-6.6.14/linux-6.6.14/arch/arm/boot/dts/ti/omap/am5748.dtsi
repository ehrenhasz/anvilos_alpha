#include "dra74x-p.dtsi"
#include "am57-pruss.dtsi"
/ {
	compatible = "ti,am5748", "ti,dra762", "ti,dra7";
};
&usb3_tm {
	status = "disabled";
};
&usb4_tm {
	status = "disabled";
};
&atl_tm {
	status = "disabled";
};
