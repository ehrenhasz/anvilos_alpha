#include "omap3-overo-common-peripherals.dtsi"
#include "omap3-overo-common-dvi.dtsi"
/ {
	leds {
		compatible = "gpio-leds";
		pinctrl-names = "default";
		pinctrl-0 = <&led_pins>;
		led-heartbeat {
			label = "overo:red:gpio21";
			gpios = <&gpio1 21 GPIO_ACTIVE_LOW>;		 
			linux,default-trigger = "heartbeat";
		};
	};
};
&lis33de {
	status = "disabled";
};
