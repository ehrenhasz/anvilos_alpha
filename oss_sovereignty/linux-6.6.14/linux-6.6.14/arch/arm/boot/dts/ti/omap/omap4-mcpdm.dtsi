&omap4_pmx_core {
	mcpdm_pins: mcpdm-pins {
		pinctrl-single,pins = <
		OMAP4_IOPAD(0x106, PIN_INPUT_PULLDOWN | MUX_MODE0)
		OMAP4_IOPAD(0x108, PIN_INPUT_PULLDOWN | MUX_MODE0)
		OMAP4_IOPAD(0x10a, PIN_INPUT_PULLUP   | MUX_MODE0)
		OMAP4_IOPAD(0x10c, PIN_INPUT_PULLDOWN | MUX_MODE0)
		OMAP4_IOPAD(0x10e, PIN_INPUT_PULLDOWN | MUX_MODE0)
		>;
	};
};
&mcpdm_module {
	pinctrl-names = "default";
	pinctrl-0 = <&mcpdm_pins>;
	status = "okay";
};
&mcpdm {
	clocks = <&twl6040>;
	clock-names = "pdmclk";
};
