#include <dt-bindings/thermal/thermal.h>
gpu_thermal: gpu_thermal {
	polling-delay-passive = <250>;  
	polling-delay = <500>;  
	thermal-sensors = <&bandgap     1>;
	trips {
		gpu_crit: gpu_crit {
			temperature = <125000>;  
			hysteresis = <2000>;  
			type = "critical";
		};
	};
};
