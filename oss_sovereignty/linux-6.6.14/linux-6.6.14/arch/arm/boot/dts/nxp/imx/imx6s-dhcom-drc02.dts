/dts-v1/;
#include "imx6dl.dtsi"
#include "imx6qdl-dhcom-som.dtsi"
#include "imx6qdl-dhcom-drc02.dtsi"
/ {
	model = "DH electronics i.MX6S DHCOM on DRC02";
	compatible = "dh,imx6s-dhcom-drc02", "dh,imx6s-dhcom-som",
		     "fsl,imx6dl";
	cpus {
		/delete-node/ cpu@1;
	};
};
