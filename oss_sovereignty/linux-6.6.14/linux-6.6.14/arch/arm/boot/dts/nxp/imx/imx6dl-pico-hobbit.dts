/dts-v1/;
#include "imx6dl.dtsi"
#include "imx6qdl-pico-hobbit.dtsi"
/ {
	model = "TechNexion PICO-IMX6 DualLite/Solo Board and Hobbit baseboard";
	compatible = "technexion,imx6dl-pico-hobbit", "fsl,imx6dl";
};
