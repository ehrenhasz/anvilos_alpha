/dts-v1/;
#include "imx7d-flex-concentrator.dts"
/ {
	model = "Kamstrup OMNIA Flex Concentrator - Manufacturing";
	compatible = "kam,imx7d-flex-concentrator-mfg", "fsl,imx7d";
	chosen {
		stdout-path = &uart4;
	};
};
&uart4 {
	status = "okay";
};
