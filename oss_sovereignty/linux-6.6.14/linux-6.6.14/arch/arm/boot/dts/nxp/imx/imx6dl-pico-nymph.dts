/dts-v1/;
#include "imx6dl.dtsi"
#include "imx6qdl-pico-pi.dtsi"
/ {
	model = "TechNexion PICO-IMX6 DualLite/Solo Board and Nymph baseboard";
	compatible = "technexion,imx6dl-pico-nymph", "fsl,imx6dl";
};
