/dts-v1/;
#include "imx6dl.dtsi"
#include "imx6qdl-ts7970.dtsi"
/ {
	model = "Technologic Systems i.MX6 Solo/DualLite TS-7970 (Default Device Tree)";
	compatible = "technologic,imx6dl-ts7970", "fsl,imx6dl";
	memory@10000000 {
		device_type = "memory";
		reg = <0x10000000 0>;
	};
};
