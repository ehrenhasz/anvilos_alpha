/dts-v1/;
#include "imx6dl.dtsi"
#include "imx6qdl-sr-som.dtsi"
#include "imx6qdl-sr-som-brcm.dtsi"
#include "imx6qdl-cubox-i.dtsi"
/ {
	model = "SolidRun Cubox-i Solo/DualLite";
	compatible = "solidrun,cubox-i/dl", "fsl,imx6dl";
};
