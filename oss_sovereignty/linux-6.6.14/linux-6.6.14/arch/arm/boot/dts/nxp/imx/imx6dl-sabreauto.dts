/dts-v1/;
#include "imx6dl.dtsi"
#include "imx6qdl-sabreauto.dtsi"
/ {
	model = "Freescale i.MX6 DualLite/Solo SABRE Automotive Board";
	compatible = "fsl,imx6dl-sabreauto", "fsl,imx6dl";
};
&cpu0 {
	operating-points = <
		996000  1275000
		792000  1175000
		396000  1150000
	>;
	fsl,soc-operating-points = <
		996000	1200000
		792000	1175000
		396000	1175000
	>;
};
