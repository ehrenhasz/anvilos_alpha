/dts-v1/;
#include "imx6qp.dtsi"
#include "imx6qdl-zii-rdu2.dtsi"
/ {
	model = "ZII RDU2+ Board";
	compatible = "zii,imx6qp-zii-rdu2", "fsl,imx6qp";
	memory@10000000 {
		device_type = "memory";
		reg = <0x10000000 0>;
	};
};
&gpu_3d {
	assigned-clocks = <&clks IMX6QDL_CLK_GPU3D_SHADER_SEL>;
	assigned-clock-parents = <&clks IMX6QDL_CLK_PLL2_PFD1_594M>;
};
