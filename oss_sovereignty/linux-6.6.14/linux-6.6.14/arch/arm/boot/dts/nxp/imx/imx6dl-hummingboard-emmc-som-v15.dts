/dts-v1/;
#include "imx6dl.dtsi"
#include "imx6qdl-sr-som.dtsi"
#include "imx6qdl-sr-som-ti.dtsi"
#include "imx6qdl-sr-som-emmc.dtsi"
#include "imx6qdl-hummingboard.dtsi"
/ {
	model = "SolidRun HummingBoard Solo/DualLite (1.5som+emmc)";
	compatible = "solidrun,hummingboard/dl", "fsl,imx6dl";
};
