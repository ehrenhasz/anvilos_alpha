/dts-v1/;
#include "imx6ull-phytec-tauri.dtsi"
/ {
	model = "PHYTEC phyGate-Tauri i.MX6 UltraLite";
	compatible = "phytec,imx6ull-phygate-tauri",
		     "phytec,imx6ull-phygate-tauri-nand",
		     "phytec,imx6ull-pcl063", "fsl,imx6ull";
};
&gpmi {
	status = "okay";
};
