/dts-v1/;
#include "imx6q.dtsi"
#include "imx6qdl-dhcom-som.dtsi"
#include "imx6qdl-dhcom-pdk2.dtsi"
/ {
	model = "DH electronics i.MX6Q DHCOM on Premium Developer Kit (2)";
	compatible = "dh,imx6q-dhcom-pdk2", "dh,imx6q-dhcom-som",
		     "fsl,imx6q";
};
&sata {
	status = "okay";
};
