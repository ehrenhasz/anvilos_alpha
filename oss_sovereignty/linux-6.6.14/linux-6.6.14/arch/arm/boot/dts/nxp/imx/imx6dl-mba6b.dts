/dts-v1/;
#include <dt-bindings/gpio/gpio.h>
#include "imx6dl-tqma6b.dtsi"
#include "imx6qdl-mba6.dtsi"
#include "imx6qdl-mba6b.dtsi"
#include "imx6dl-mba6.dtsi"
/ {
	model = "TQ TQMa6S/DL on MBa6x";
	compatible = "tq,imx6dl-mba6x-b", "tq,mba6b",
		     "tq,imx6dl-tqma6dl-b", "fsl,imx6dl";
};
