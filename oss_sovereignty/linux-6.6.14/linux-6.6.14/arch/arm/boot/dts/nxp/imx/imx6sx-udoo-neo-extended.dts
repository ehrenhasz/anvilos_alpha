/dts-v1/;
#include "imx6sx-udoo-neo.dtsi"
/ {
	model = "UDOO Neo Extended";
	compatible = "udoo,neoextended", "fsl,imx6sx";
	memory@80000000 {
		device_type = "memory";
		reg = <0x80000000 0x40000000>;
	};
};
&i2c4 {  
	status = "okay";
};
&uart3 {  
	status = "okay";
};
