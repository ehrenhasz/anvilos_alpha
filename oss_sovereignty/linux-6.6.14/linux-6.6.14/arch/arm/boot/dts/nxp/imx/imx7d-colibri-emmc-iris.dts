/dts-v1/;
#include "imx7d-colibri-emmc.dtsi"
#include "imx7-colibri-iris.dtsi"
/ {
	model = "Toradex Colibri iMX7D 1GB on Iris Carrier Board";
	compatible = "toradex,colibri-imx7d-emmc-iris",
		     "toradex,colibri-imx7d-emmc",
		     "toradex,colibri-imx7d",
		     "fsl,imx7d";
};
&usbotg2 {
	disable-over-current;
	status = "okay";
};
