/dts-v1/;
#include "imx6q.dtsi"
#include "imx6qdl-ts7970.dtsi"
/ {
	model = "Technologic Systems i.MX6 Quad TS-7970 (Default Device Tree)";
	compatible = "technologic,imx6q-ts7970", "fsl,imx6q";
	memory@10000000 {
		device_type = "memory";
		reg = <0x10000000 0>;
	};
};
&sata {
	status = "okay";
};
