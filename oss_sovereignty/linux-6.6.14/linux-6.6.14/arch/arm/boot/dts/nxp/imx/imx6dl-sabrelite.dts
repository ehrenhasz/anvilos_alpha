/dts-v1/;
#include "imx6dl.dtsi"
#include "imx6qdl-sabrelite.dtsi"
/ {
	model = "Freescale i.MX6 DualLite SABRE Lite Board";
	compatible = "fsl,imx6dl-sabrelite", "fsl,imx6dl";
};
&ipu1_csi1_from_ipu1_csi1_mux {
	clock-lanes = <0>;
	data-lanes = <1 2>;
};
