/dts-v1/;
#include "imx6ull.dtsi"
#include "imx6ull-myir-mys-6ulx.dtsi"
/ {
	model = "MYiR i.MX6ULL MYS-6ULX Single Board Computer with NAND";
	compatible = "myir,imx6ull-mys-6ulx-eval", "fsl,imx6ull";
};
&gpmi {
	fsl,use-minimum-ecc;
	status = "okay";
};
