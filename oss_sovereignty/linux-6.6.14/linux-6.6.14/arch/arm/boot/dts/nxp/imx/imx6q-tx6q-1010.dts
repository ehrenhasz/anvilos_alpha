/dts-v1/;
#include "imx6q.dtsi"
#include "imx6qdl-tx6.dtsi"
#include "imx6qdl-tx6-lcd.dtsi"
/ {
	model = "Ka-Ro electronics TX6Q-1010/-1030 Module";
	compatible = "karo,imx6q-tx6q", "fsl,imx6q";
};
&ipu2 {
	status = "disabled";
};
