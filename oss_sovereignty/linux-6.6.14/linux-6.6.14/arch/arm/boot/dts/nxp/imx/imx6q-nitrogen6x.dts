/dts-v1/;
#include "imx6q.dtsi"
#include "imx6qdl-nitrogen6x.dtsi"
/ {
	model = "Boundary Devices i.MX6 Quad Nitrogen6x Board";
	compatible = "boundary,imx6q-nitrogen6x", "fsl,imx6q";
};
&sata {
	status = "okay";
};
