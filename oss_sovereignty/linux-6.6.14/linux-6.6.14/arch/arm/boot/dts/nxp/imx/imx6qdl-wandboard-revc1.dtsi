#include "imx6qdl-wandboard.dtsi"
&iomuxc {
	pinctrl-0 = <&pinctrl_hog>;
	imx6qdl-wandboard {
		pinctrl_hog: hoggrp {
			fsl,pins = <
				MX6QDL_PAD_GPIO_2__GPIO1_IO02		0x80000000	 
				MX6QDL_PAD_EIM_DA9__GPIO3_IO09		0x80000000	 
				MX6QDL_PAD_CSI0_DAT14__GPIO6_IO00	0x0f0b0		 
				MX6QDL_PAD_ENET_RXD1__GPIO1_IO26	0x000b0		 
				MX6QDL_PAD_ENET_TXD1__GPIO1_IO29	0x80000000	 
				MX6QDL_PAD_CSI0_DAT13__GPIO5_IO31	0x0f0b0		 
				MX6QDL_PAD_ENET_TXD0__GPIO1_IO30	0x80000000	 
				MX6QDL_PAD_CSI0_VSYNC__GPIO5_IO21	0x80000000	 
				MX6QDL_PAD_CSI0_DAT12__GPIO5_IO30	0x80000000	 
				MX6QDL_PAD_CSI0_DATA_EN__GPIO5_IO20	0x80000000	 
				MX6QDL_PAD_EIM_D29__GPIO3_IO29		0x80000000	 
			>;
		};
	};
};
&usdhc2 {
	pinctrl-names = "default";
	pinctrl-0 = <&pinctrl_usdhc2>;
	status = "okay";
};
