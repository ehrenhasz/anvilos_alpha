#include "imx6ul-phytec-segin-peb-av-02.dtsi"
&iomuxc {
	/delete-node/ edtft5406grp;
	/delete-node/ stmpegrp;
};
&iomuxc_snvs {
	pinctrl_edt_ft5406: edtft5406grp {
		fsl,pins = <
			MX6ULL_PAD_SNVS_TAMPER5__GPIO5_IO05	0x1b0b0
		>;
	};
	pinctrl_stmpe: stmpegrp {
		fsl,pins = <
			MX6ULL_PAD_SNVS_TAMPER3__GPIO5_IO03	0x17059
		>;
	};
};
