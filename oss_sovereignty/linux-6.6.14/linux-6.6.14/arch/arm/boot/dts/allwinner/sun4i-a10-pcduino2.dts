#include "sun4i-a10-pcduino.dts"
/ {
	model = "LinkSprite pcDuino2";
	compatible = "linksprite,a10-pcduino2", "allwinner,sun4i-a10";
};
&reg_usb2_vbus {
	gpio = <&pio 3 2 GPIO_ACTIVE_HIGH>;
	status = "okay";
};
&usbphy {
	usb1_vbus-supply = <&reg_vcc3v3>;  
	usb2_vbus-supply = <&reg_usb2_vbus>;
	status = "okay";
};
