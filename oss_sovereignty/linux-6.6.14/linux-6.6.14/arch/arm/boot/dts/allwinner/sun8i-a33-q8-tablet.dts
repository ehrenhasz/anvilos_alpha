/dts-v1/;
#include "sun8i-a33.dtsi"
#include "sun8i-q8-common.dtsi"
/ {
	model = "Q8 A33 Tablet";
	compatible = "allwinner,q8-a33", "allwinner,sun8i-a33";
};
&tcon0_out {
	tcon0_out_lcd: endpoint@0 {
		reg = <0>;
		remote-endpoint = <&panel_input>;
	};
};
