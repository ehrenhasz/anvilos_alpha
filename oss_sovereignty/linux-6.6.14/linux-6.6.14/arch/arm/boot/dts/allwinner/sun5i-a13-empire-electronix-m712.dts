/dts-v1/;
#include "sun5i-a13.dtsi"
#include "sun5i-reference-design-tablet.dtsi"
#include <dt-bindings/interrupt-controller/irq.h>
/ {
	model = "Empire Electronix M712 tablet";
	compatible = "empire-electronix,m712", "allwinner,sun5i-a13";
};
