/dts-v1/;
#include "sun8i-h3.dtsi"
#include "sunxi-libretech-all-h3-cc.dtsi"
/ {
	model = "Libre Computer Board ALL-H3-CC H2+";
	compatible = "libretech,all-h3-cc-h2-plus", "allwinner,sun8i-h2-plus";
};
