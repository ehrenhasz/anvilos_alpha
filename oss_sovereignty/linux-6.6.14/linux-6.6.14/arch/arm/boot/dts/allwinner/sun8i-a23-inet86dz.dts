/dts-v1/;
#include "sun8i-a23.dtsi"
#include "sun8i-reference-design-tablet.dtsi"
/ {
	model = "INet-86DZ Rev 01";
	compatible = "primux,inet86dz", "allwinner,sun8i-a23";
};
&ehci0 {
	status = "okay";
};
&touchscreen {
	reg = <0x40>;
	compatible = "silead,gsl1680";
	firmware-name = "gsl1680-inet86dz.fw";
	touchscreen-size-x = <960>;
	touchscreen-size-y = <640>;
	status = "okay";
};
&usbphy {
	usb1_vbus-supply = <&reg_dldo1>;
};
