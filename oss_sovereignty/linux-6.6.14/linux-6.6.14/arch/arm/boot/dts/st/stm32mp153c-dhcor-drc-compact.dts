/dts-v1/;
#include "stm32mp153.dtsi"
#include "stm32mp15xc.dtsi"
#include "stm32mp15xx-dhcor-som.dtsi"
#include "stm32mp15xx-dhcor-drc-compact.dtsi"
/ {
	model = "DH electronics STM32MP153C DHCOR DRC Compact";
	compatible = "dh,stm32mp153c-dhcor-drc-compact",
		     "dh,stm32mp153c-dhcor-som",
		     "st,stm32mp153";
};
&m_can1 {
	pinctrl-names = "default", "sleep";
	pinctrl-0 = <&m_can1_pins_c>;
	pinctrl-1 = <&m_can1_sleep_pins_c>;
	status = "okay";
};
