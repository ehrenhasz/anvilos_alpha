/ {
	vdd_io: regulator-buck-io {
		compatible = "regulator-fixed";
		regulator-name = "buck-io";
		regulator-min-microvolt = <1800000>;
		regulator-max-microvolt = <1800000>;
		regulator-always-on;
		regulator-boot-on;
		vin-supply = <&vdd>;
	};
};
&vdd {
	regulator-min-microvolt = <2900000>;
	regulator-max-microvolt = <2900000>;
};
&pwr_regulators {
	vdd-supply = <&vdd_io>;
};
