#include <dt-bindings/pinctrl/stm32-pinfunc.h>
&pinctrl {
	adc1_ain_pins_a: adc1-ain-0 {
		pins {
			pinmux = <STM32_PINMUX('F', 11, ANALOG)>,  
				 <STM32_PINMUX('B', 1, ANALOG)>,  
				 <STM32_PINMUX('B', 0, ANALOG)>,  
				 <STM32_PINMUX('C', 0, ANALOG)>,  
				 <STM32_PINMUX('C', 3, ANALOG)>,  
				 <STM32_PINMUX('A', 3, ANALOG)>;  
		};
	};
	adc1_in6_pins_a: adc1-in6-0 {
		pins {
			pinmux = <STM32_PINMUX('F', 12, ANALOG)>;
		};
	};
	adc12_ain_pins_a: adc12-ain-0 {
		pins {
			pinmux = <STM32_PINMUX('C', 3, ANALOG)>,  
				 <STM32_PINMUX('F', 12, ANALOG)>,  
				 <STM32_PINMUX('F', 13, ANALOG)>,  
				 <STM32_PINMUX('F', 14, ANALOG)>;  
		};
	};
	adc12_ain_pins_b: adc12-ain-1 {
		pins {
			pinmux = <STM32_PINMUX('F', 12, ANALOG)>,  
				 <STM32_PINMUX('F', 13, ANALOG)>;  
		};
	};
	adc12_usb_cc_pins_a: adc12-usb-cc-pins-0 {
		pins {
			pinmux = <STM32_PINMUX('A', 4, ANALOG)>,  
				 <STM32_PINMUX('A', 5, ANALOG)>;  
		};
	};
	cec_pins_a: cec-0 {
		pins {
			pinmux = <STM32_PINMUX('A', 15, AF4)>;
			bias-disable;
			drive-open-drain;
			slew-rate = <0>;
		};
	};
	cec_sleep_pins_a: cec-sleep-0 {
		pins {
			pinmux = <STM32_PINMUX('A', 15, ANALOG)>;  
		};
	};
	cec_pins_b: cec-1 {
		pins {
			pinmux = <STM32_PINMUX('B', 6, AF5)>;
			bias-disable;
			drive-open-drain;
			slew-rate = <0>;
		};
	};
	cec_sleep_pins_b: cec-sleep-1 {
		pins {
			pinmux = <STM32_PINMUX('B', 6, ANALOG)>;  
		};
	};
	dac_ch1_pins_a: dac-ch1-0 {
		pins {
			pinmux = <STM32_PINMUX('A', 4, ANALOG)>;
		};
	};
	dac_ch2_pins_a: dac-ch2-0 {
		pins {
			pinmux = <STM32_PINMUX('A', 5, ANALOG)>;
		};
	};
	dcmi_pins_a: dcmi-0 {
		pins {
			pinmux = <STM32_PINMUX('H', 8,  AF13)>, 
				 <STM32_PINMUX('B', 7,  AF13)>, 
				 <STM32_PINMUX('A', 6,  AF13)>, 
				 <STM32_PINMUX('H', 9,  AF13)>, 
				 <STM32_PINMUX('H', 10, AF13)>, 
				 <STM32_PINMUX('H', 11, AF13)>, 
				 <STM32_PINMUX('H', 12, AF13)>, 
				 <STM32_PINMUX('H', 14, AF13)>, 
				 <STM32_PINMUX('I', 4,  AF13)>, 
				 <STM32_PINMUX('B', 8,  AF13)>, 
				 <STM32_PINMUX('E', 6,  AF13)>, 
				 <STM32_PINMUX('I', 1,  AF13)>, 
				 <STM32_PINMUX('H', 7,  AF13)>, 
				 <STM32_PINMUX('I', 3,  AF13)>, 
				 <STM32_PINMUX('H', 15, AF13)>; 
			bias-disable;
		};
	};
	dcmi_sleep_pins_a: dcmi-sleep-0 {
		pins {
			pinmux = <STM32_PINMUX('H', 8,  ANALOG)>, 
				 <STM32_PINMUX('B', 7,  ANALOG)>, 
				 <STM32_PINMUX('A', 6,  ANALOG)>, 
				 <STM32_PINMUX('H', 9,  ANALOG)>, 
				 <STM32_PINMUX('H', 10, ANALOG)>, 
				 <STM32_PINMUX('H', 11, ANALOG)>, 
				 <STM32_PINMUX('H', 12, ANALOG)>, 
				 <STM32_PINMUX('H', 14, ANALOG)>, 
				 <STM32_PINMUX('I', 4,  ANALOG)>, 
				 <STM32_PINMUX('B', 8,  ANALOG)>, 
				 <STM32_PINMUX('E', 6,  ANALOG)>, 
				 <STM32_PINMUX('I', 1,  ANALOG)>, 
				 <STM32_PINMUX('H', 7,  ANALOG)>, 
				 <STM32_PINMUX('I', 3,  ANALOG)>, 
				 <STM32_PINMUX('H', 15, ANALOG)>; 
		};
	};
	dcmi_pins_b: dcmi-1 {
		pins {
			pinmux = <STM32_PINMUX('A', 4,  AF13)>, 
				 <STM32_PINMUX('B', 7,  AF13)>, 
				 <STM32_PINMUX('A', 6,  AF13)>, 
				 <STM32_PINMUX('C', 6,  AF13)>, 
				 <STM32_PINMUX('H', 10, AF13)>, 
				 <STM32_PINMUX('H', 11, AF13)>, 
				 <STM32_PINMUX('E', 1,  AF13)>, 
				 <STM32_PINMUX('E', 11, AF13)>, 
				 <STM32_PINMUX('D', 3,  AF13)>, 
				 <STM32_PINMUX('E', 13, AF13)>, 
				 <STM32_PINMUX('B', 9,  AF13)>; 
			bias-disable;
		};
	};
	dcmi_sleep_pins_b: dcmi-sleep-1 {
		pins {
			pinmux = <STM32_PINMUX('A', 4,  ANALOG)>, 
				 <STM32_PINMUX('B', 7,  ANALOG)>, 
				 <STM32_PINMUX('A', 6,  ANALOG)>, 
				 <STM32_PINMUX('C', 6,  ANALOG)>, 
				 <STM32_PINMUX('H', 10, ANALOG)>, 
				 <STM32_PINMUX('H', 11, ANALOG)>, 
				 <STM32_PINMUX('E', 1,  ANALOG)>, 
				 <STM32_PINMUX('E', 11, ANALOG)>, 
				 <STM32_PINMUX('D', 3,  ANALOG)>, 
				 <STM32_PINMUX('E', 13, ANALOG)>, 
				 <STM32_PINMUX('B', 9,  ANALOG)>; 
		};
	};
	dcmi_pins_c: dcmi-2 {
		pins {
			pinmux = <STM32_PINMUX('A', 4,  AF13)>, 
				 <STM32_PINMUX('B', 7,  AF13)>, 
				 <STM32_PINMUX('A', 6,  AF13)>, 
				 <STM32_PINMUX('A', 9,  AF13)>, 
				 <STM32_PINMUX('H', 10, AF13)>, 
				 <STM32_PINMUX('E', 0, AF13)>, 
				 <STM32_PINMUX('E', 1, AF13)>, 
				 <STM32_PINMUX('H', 14, AF13)>, 
				 <STM32_PINMUX('I', 4,  AF13)>, 
				 <STM32_PINMUX('I', 6,  AF13)>, 
				 <STM32_PINMUX('E', 6,  AF13)>, 
				 <STM32_PINMUX('I', 1,  AF13)>, 
				 <STM32_PINMUX('H', 7,  AF13)>; 
			bias-pull-up;
		};
	};
	dcmi_sleep_pins_c: dcmi-sleep-2 {
		pins {
			pinmux = <STM32_PINMUX('A', 4,  ANALOG)>, 
				 <STM32_PINMUX('B', 7,  ANALOG)>, 
				 <STM32_PINMUX('A', 6,  ANALOG)>, 
				 <STM32_PINMUX('A', 9,  ANALOG)>, 
				 <STM32_PINMUX('H', 10, ANALOG)>, 
				 <STM32_PINMUX('E', 0, ANALOG)>, 
				 <STM32_PINMUX('E', 1, ANALOG)>, 
				 <STM32_PINMUX('H', 14, ANALOG)>, 
				 <STM32_PINMUX('I', 4,  ANALOG)>, 
				 <STM32_PINMUX('I', 6,  ANALOG)>, 
				 <STM32_PINMUX('E', 6,  ANALOG)>, 
				 <STM32_PINMUX('I', 1,  ANALOG)>, 
				 <STM32_PINMUX('H', 7,  ANALOG)>; 
		};
	};
	ethernet0_rgmii_pins_a: rgmii-0 {
		pins1 {
			pinmux = <STM32_PINMUX('G', 5, AF11)>,  
				 <STM32_PINMUX('G', 4, AF11)>,  
				 <STM32_PINMUX('G', 13, AF11)>,  
				 <STM32_PINMUX('G', 14, AF11)>,  
				 <STM32_PINMUX('C', 2, AF11)>,  
				 <STM32_PINMUX('E', 2, AF11)>,  
				 <STM32_PINMUX('B', 11, AF11)>,  
				 <STM32_PINMUX('C', 1, AF11)>;  
			bias-disable;
			drive-push-pull;
			slew-rate = <2>;
		};
		pins2 {
			pinmux = <STM32_PINMUX('A', 2, AF11)>;  
			bias-disable;
			drive-push-pull;
			slew-rate = <0>;
		};
		pins3 {
			pinmux = <STM32_PINMUX('C', 4, AF11)>,  
				 <STM32_PINMUX('C', 5, AF11)>,  
				 <STM32_PINMUX('B', 0, AF11)>,  
				 <STM32_PINMUX('B', 1, AF11)>,  
				 <STM32_PINMUX('A', 1, AF11)>,  
				 <STM32_PINMUX('A', 7, AF11)>;  
			bias-disable;
		};
	};
	ethernet0_rgmii_sleep_pins_a: rgmii-sleep-0 {
		pins1 {
			pinmux = <STM32_PINMUX('G', 5, ANALOG)>,  
				 <STM32_PINMUX('G', 4, ANALOG)>,  
				 <STM32_PINMUX('G', 13, ANALOG)>,  
				 <STM32_PINMUX('G', 14, ANALOG)>,  
				 <STM32_PINMUX('C', 2, ANALOG)>,  
				 <STM32_PINMUX('E', 2, ANALOG)>,  
				 <STM32_PINMUX('B', 11, ANALOG)>,  
				 <STM32_PINMUX('A', 2, ANALOG)>,  
				 <STM32_PINMUX('C', 1, ANALOG)>,  
				 <STM32_PINMUX('C', 4, ANALOG)>,  
				 <STM32_PINMUX('C', 5, ANALOG)>,  
				 <STM32_PINMUX('B', 0, ANALOG)>,  
				 <STM32_PINMUX('B', 1, ANALOG)>,  
				 <STM32_PINMUX('A', 1, ANALOG)>,  
				 <STM32_PINMUX('A', 7, ANALOG)>;  
		};
	};
	ethernet0_rgmii_pins_b: rgmii-1 {
		pins1 {
			pinmux = <STM32_PINMUX('G', 5, AF11)>,  
				 <STM32_PINMUX('G', 4, AF11)>,  
				 <STM32_PINMUX('G', 13, AF11)>,  
				 <STM32_PINMUX('G', 14, AF11)>,  
				 <STM32_PINMUX('C', 2, AF11)>,  
				 <STM32_PINMUX('E', 2, AF11)>,  
				 <STM32_PINMUX('B', 11, AF11)>,  
				 <STM32_PINMUX('C', 1, AF11)>;  
			bias-disable;
			drive-push-pull;
			slew-rate = <2>;
		};
		pins2 {
			pinmux = <STM32_PINMUX('A', 2, AF11)>;  
			bias-disable;
			drive-push-pull;
			slew-rate = <0>;
		};
		pins3 {
			pinmux = <STM32_PINMUX('C', 4, AF11)>,  
				 <STM32_PINMUX('C', 5, AF11)>,  
				 <STM32_PINMUX('H', 6, AF11)>,  
				 <STM32_PINMUX('H', 7, AF11)>,  
				 <STM32_PINMUX('A', 1, AF11)>,  
				 <STM32_PINMUX('A', 7, AF11)>;  
			bias-disable;
		};
	};
	ethernet0_rgmii_sleep_pins_b: rgmii-sleep-1 {
		pins1 {
			pinmux = <STM32_PINMUX('G', 5, ANALOG)>,  
				 <STM32_PINMUX('G', 4, ANALOG)>,  
				 <STM32_PINMUX('G', 13, ANALOG)>,  
				 <STM32_PINMUX('G', 14, ANALOG)>,  
				 <STM32_PINMUX('C', 2, ANALOG)>,  
				 <STM32_PINMUX('E', 2, ANALOG)>,  
				 <STM32_PINMUX('B', 11, ANALOG)>,  
				 <STM32_PINMUX('C', 1, ANALOG)>,  
				 <STM32_PINMUX('A', 2, ANALOG)>,  
				 <STM32_PINMUX('C', 4, ANALOG)>,  
				 <STM32_PINMUX('C', 5, ANALOG)>,  
				 <STM32_PINMUX('H', 6, ANALOG)>,  
				 <STM32_PINMUX('H', 7, ANALOG)>,  
				 <STM32_PINMUX('A', 1, ANALOG)>,  
				 <STM32_PINMUX('A', 7, ANALOG)>;  
		 };
	};
	ethernet0_rgmii_pins_c: rgmii-2 {
		pins1 {
			pinmux = <STM32_PINMUX('G', 5, AF11)>,  
				 <STM32_PINMUX('G', 4, AF11)>,  
				 <STM32_PINMUX('B', 12, AF11)>,  
				 <STM32_PINMUX('G', 14, AF11)>,  
				 <STM32_PINMUX('C', 2, AF11)>,  
				 <STM32_PINMUX('E', 2, AF11)>,  
				 <STM32_PINMUX('G', 11, AF11)>,  
				 <STM32_PINMUX('C', 1, AF11)>;  
			bias-disable;
			drive-push-pull;
			slew-rate = <2>;
		};
		pins2 {
			pinmux = <STM32_PINMUX('A', 2, AF11)>;  
			bias-disable;
			drive-push-pull;
			slew-rate = <0>;
		};
		pins3 {
			pinmux = <STM32_PINMUX('C', 4, AF11)>,  
				 <STM32_PINMUX('C', 5, AF11)>,  
				 <STM32_PINMUX('H', 6, AF11)>,  
				 <STM32_PINMUX('B', 1, AF11)>,  
				 <STM32_PINMUX('A', 1, AF11)>,  
				 <STM32_PINMUX('A', 7, AF11)>;  
			bias-disable;
		};
	};
	ethernet0_rgmii_sleep_pins_c: rgmii-sleep-2 {
		pins1 {
			pinmux = <STM32_PINMUX('G', 5, ANALOG)>,  
				 <STM32_PINMUX('G', 4, ANALOG)>,  
				 <STM32_PINMUX('B', 12, ANALOG)>,  
				 <STM32_PINMUX('G', 14, ANALOG)>,  
				 <STM32_PINMUX('C', 2, ANALOG)>,  
				 <STM32_PINMUX('E', 2, ANALOG)>,  
				 <STM32_PINMUX('G', 11, ANALOG)>,  
				 <STM32_PINMUX('A', 2, ANALOG)>,  
				 <STM32_PINMUX('C', 1, ANALOG)>,  
				 <STM32_PINMUX('C', 4, ANALOG)>,  
				 <STM32_PINMUX('C', 5, ANALOG)>,  
				 <STM32_PINMUX('H', 6, ANALOG)>,  
				 <STM32_PINMUX('B', 1, ANALOG)>,  
				 <STM32_PINMUX('A', 1, ANALOG)>,  
				 <STM32_PINMUX('A', 7, ANALOG)>;  
		};
	};
	ethernet0_rgmii_pins_d: rgmii-3 {
		pins1 {
			pinmux = <STM32_PINMUX('G', 5, AF11)>,  
				 <STM32_PINMUX('G', 13, AF11)>,	 
				 <STM32_PINMUX('G', 14, AF11)>,	 
				 <STM32_PINMUX('C', 2, AF11)>,  
				 <STM32_PINMUX('E', 2, AF11)>,  
				 <STM32_PINMUX('B', 11, AF11)>,	 
				 <STM32_PINMUX('C', 1, AF11)>;  
			bias-disable;
			drive-push-pull;
			slew-rate = <2>;
		};
		pins2 {
			pinmux = <STM32_PINMUX('A', 2, AF11)>;  
			bias-disable;
			drive-push-pull;
			slew-rate = <0>;
		};
		pins3 {
			pinmux = <STM32_PINMUX('C', 4, AF11)>,  
				 <STM32_PINMUX('C', 5, AF11)>,  
				 <STM32_PINMUX('H', 6, AF11)>,  
				 <STM32_PINMUX('B', 1, AF11)>,  
				 <STM32_PINMUX('A', 1, AF11)>,  
				 <STM32_PINMUX('A', 7, AF11)>;  
			bias-disable;
		};
	};
	ethernet0_rgmii_sleep_pins_d: rgmii-sleep-3 {
		pins1 {
			pinmux = <STM32_PINMUX('G', 5, ANALOG)>,  
				 <STM32_PINMUX('G', 4, ANALOG)>,  
				 <STM32_PINMUX('G', 13, ANALOG)>,  
				 <STM32_PINMUX('G', 14, ANALOG)>,  
				 <STM32_PINMUX('C', 2, ANALOG)>,  
				 <STM32_PINMUX('E', 2, ANALOG)>,  
				 <STM32_PINMUX('B', 11, ANALOG)>,  
				 <STM32_PINMUX('A', 2, ANALOG)>,  
				 <STM32_PINMUX('C', 1, ANALOG)>,  
				 <STM32_PINMUX('C', 4, ANALOG)>,  
				 <STM32_PINMUX('C', 5, ANALOG)>,  
				 <STM32_PINMUX('H', 6, ANALOG)>,  
				 <STM32_PINMUX('B', 1, ANALOG)>,  
				 <STM32_PINMUX('A', 1, ANALOG)>,  
				 <STM32_PINMUX('A', 7, ANALOG)>;  
		};
	};
	ethernet0_rgmii_pins_e: rgmii-4 {
		pins1 {
			pinmux = <STM32_PINMUX('G', 4, AF11)>,  
				 <STM32_PINMUX('G', 13, AF11)>,  
				 <STM32_PINMUX('G', 14, AF11)>,  
				 <STM32_PINMUX('C', 2, AF11)>,  
				 <STM32_PINMUX('E', 2, AF11)>,  
				 <STM32_PINMUX('B', 11, AF11)>;  
			bias-disable;
			drive-push-pull;
			slew-rate = <2>;
		};
		pins2 {
			pinmux = <STM32_PINMUX('C', 4, AF11)>,  
				 <STM32_PINMUX('C', 5, AF11)>,  
				 <STM32_PINMUX('H', 6, AF11)>,  
				 <STM32_PINMUX('H', 7, AF11)>,  
				 <STM32_PINMUX('A', 1, AF11)>,  
				 <STM32_PINMUX('A', 7, AF11)>;  
			bias-disable;
		};
	};
	ethernet0_rgmii_sleep_pins_e: rgmii-sleep-4 {
		pins1 {
			pinmux = <STM32_PINMUX('G', 4, ANALOG)>,  
				 <STM32_PINMUX('G', 13, ANALOG)>,  
				 <STM32_PINMUX('G', 14, ANALOG)>,  
				 <STM32_PINMUX('C', 2, ANALOG)>,  
				 <STM32_PINMUX('E', 2, ANALOG)>,  
				 <STM32_PINMUX('B', 11, ANALOG)>,  
				 <STM32_PINMUX('C', 4, ANALOG)>,  
				 <STM32_PINMUX('C', 5, ANALOG)>,  
				 <STM32_PINMUX('H', 6, ANALOG)>,  
				 <STM32_PINMUX('H', 7, ANALOG)>,  
				 <STM32_PINMUX('A', 1, ANALOG)>,  
				 <STM32_PINMUX('A', 7, ANALOG)>;  
		};
	};
	ethernet0_rmii_pins_a: rmii-0 {
		pins1 {
			pinmux = <STM32_PINMUX('G', 13, AF11)>,  
				 <STM32_PINMUX('G', 14, AF11)>,  
				 <STM32_PINMUX('B', 11, AF11)>,  
				 <STM32_PINMUX('A', 1, AF0)>,    
				 <STM32_PINMUX('A', 2, AF11)>,   
				 <STM32_PINMUX('C', 1, AF11)>;   
			bias-disable;
			drive-push-pull;
			slew-rate = <2>;
		};
		pins2 {
			pinmux = <STM32_PINMUX('C', 4, AF11)>,   
				 <STM32_PINMUX('C', 5, AF11)>,   
				 <STM32_PINMUX('A', 7, AF11)>;   
			bias-disable;
		};
	};
	ethernet0_rmii_sleep_pins_a: rmii-sleep-0 {
		pins1 {
			pinmux = <STM32_PINMUX('G', 13, ANALOG)>,  
				 <STM32_PINMUX('G', 14, ANALOG)>,  
				 <STM32_PINMUX('B', 11, ANALOG)>,  
				 <STM32_PINMUX('A', 2, ANALOG)>,   
				 <STM32_PINMUX('C', 1, ANALOG)>,   
				 <STM32_PINMUX('C', 4, ANALOG)>,   
				 <STM32_PINMUX('C', 5, ANALOG)>,   
				 <STM32_PINMUX('A', 1, ANALOG)>,   
				 <STM32_PINMUX('A', 7, ANALOG)>;   
		};
	};
	ethernet0_rmii_pins_b: rmii-1 {
		pins1 {
			pinmux = <STM32_PINMUX('B', 5, AF0)>,  
				<STM32_PINMUX('C', 1, AF11)>,  
				<STM32_PINMUX('G', 13, AF11)>,  
				<STM32_PINMUX('G', 14, AF11)>;  
			bias-disable;
			drive-push-pull;
			slew-rate = <1>;
		};
		pins2 {
			pinmux = <STM32_PINMUX('A', 2, AF11)>;  
			bias-disable;
			drive-push-pull;
			slew-rate = <0>;
		};
		pins3 {
			pinmux = <STM32_PINMUX('A', 7, AF11)>,  
				<STM32_PINMUX('C', 4, AF11)>,  
				<STM32_PINMUX('C', 5, AF11)>;  
			bias-disable;
		};
		pins4 {
			pinmux = <STM32_PINMUX('B', 11, AF11)>;  
		};
	};
	ethernet0_rmii_sleep_pins_b: rmii-sleep-1 {
		pins1 {
			pinmux = <STM32_PINMUX('A', 2, ANALOG)>,  
				<STM32_PINMUX('A', 7, ANALOG)>,  
				<STM32_PINMUX('B', 5, ANALOG)>,  
				<STM32_PINMUX('B', 11, ANALOG)>,  
				<STM32_PINMUX('C', 1, ANALOG)>,  
				<STM32_PINMUX('C', 4, ANALOG)>,  
				<STM32_PINMUX('C', 5, ANALOG)>,  
				<STM32_PINMUX('G', 13, ANALOG)>,  
				<STM32_PINMUX('G', 14, ANALOG)>;  
		};
	};
	ethernet0_rmii_pins_c: rmii-2 {
		pins1 {
			pinmux = <STM32_PINMUX('G', 13, AF11)>,  
				 <STM32_PINMUX('G', 14, AF11)>,  
				 <STM32_PINMUX('B', 11, AF11)>,  
				 <STM32_PINMUX('A', 1, AF11)>,   
				 <STM32_PINMUX('A', 2, AF11)>,   
				 <STM32_PINMUX('C', 1, AF11)>;   
			bias-disable;
			drive-push-pull;
			slew-rate = <2>;
		};
		pins2 {
			pinmux = <STM32_PINMUX('C', 4, AF11)>,   
				 <STM32_PINMUX('C', 5, AF11)>,   
				 <STM32_PINMUX('A', 7, AF11)>;   
			bias-disable;
		};
	};
	ethernet0_rmii_sleep_pins_c: rmii-sleep-2 {
		pins1 {
			pinmux = <STM32_PINMUX('G', 13, ANALOG)>,  
				 <STM32_PINMUX('G', 14, ANALOG)>,  
				 <STM32_PINMUX('B', 11, ANALOG)>,  
				 <STM32_PINMUX('A', 2, ANALOG)>,   
				 <STM32_PINMUX('C', 1, ANALOG)>,   
				 <STM32_PINMUX('C', 4, ANALOG)>,   
				 <STM32_PINMUX('C', 5, ANALOG)>,   
				 <STM32_PINMUX('A', 1, ANALOG)>,   
				 <STM32_PINMUX('A', 7, ANALOG)>;   
		};
	};
	fmc_pins_a: fmc-0 {
		pins1 {
			pinmux = <STM32_PINMUX('D', 4, AF12)>,  
				 <STM32_PINMUX('D', 5, AF12)>,  
				 <STM32_PINMUX('D', 11, AF12)>,  
				 <STM32_PINMUX('D', 12, AF12)>,  
				 <STM32_PINMUX('D', 14, AF12)>,  
				 <STM32_PINMUX('D', 15, AF12)>,  
				 <STM32_PINMUX('D', 0, AF12)>,  
				 <STM32_PINMUX('D', 1, AF12)>,  
				 <STM32_PINMUX('E', 7, AF12)>,  
				 <STM32_PINMUX('E', 8, AF12)>,  
				 <STM32_PINMUX('E', 9, AF12)>,  
				 <STM32_PINMUX('E', 10, AF12)>,  
				 <STM32_PINMUX('G', 9, AF12)>;  
			bias-disable;
			drive-push-pull;
			slew-rate = <1>;
		};
		pins2 {
			pinmux = <STM32_PINMUX('D', 6, AF12)>;  
			bias-pull-up;
		};
	};
	fmc_sleep_pins_a: fmc-sleep-0 {
		pins {
			pinmux = <STM32_PINMUX('D', 4, ANALOG)>,  
				 <STM32_PINMUX('D', 5, ANALOG)>,  
				 <STM32_PINMUX('D', 11, ANALOG)>,  
				 <STM32_PINMUX('D', 12, ANALOG)>,  
				 <STM32_PINMUX('D', 14, ANALOG)>,  
				 <STM32_PINMUX('D', 15, ANALOG)>,  
				 <STM32_PINMUX('D', 0, ANALOG)>,  
				 <STM32_PINMUX('D', 1, ANALOG)>,  
				 <STM32_PINMUX('E', 7, ANALOG)>,  
				 <STM32_PINMUX('E', 8, ANALOG)>,  
				 <STM32_PINMUX('E', 9, ANALOG)>,  
				 <STM32_PINMUX('E', 10, ANALOG)>,  
				 <STM32_PINMUX('D', 6, ANALOG)>,  
				 <STM32_PINMUX('G', 9, ANALOG)>;  
		};
	};
	fmc_pins_b: fmc-1 {
		pins {
			pinmux = <STM32_PINMUX('D', 4, AF12)>,  
				 <STM32_PINMUX('D', 5, AF12)>,  
				 <STM32_PINMUX('B', 7, AF12)>,  
				 <STM32_PINMUX('D', 14, AF12)>,  
				 <STM32_PINMUX('D', 15, AF12)>,  
				 <STM32_PINMUX('D', 0, AF12)>,  
				 <STM32_PINMUX('D', 1, AF12)>,  
				 <STM32_PINMUX('E', 7, AF12)>,  
				 <STM32_PINMUX('E', 8, AF12)>,  
				 <STM32_PINMUX('E', 9, AF12)>,  
				 <STM32_PINMUX('E', 10, AF12)>,  
				 <STM32_PINMUX('E', 11, AF12)>,  
				 <STM32_PINMUX('E', 12, AF12)>,  
				 <STM32_PINMUX('E', 13, AF12)>,  
				 <STM32_PINMUX('E', 14, AF12)>,  
				 <STM32_PINMUX('E', 15, AF12)>,  
				 <STM32_PINMUX('D', 8, AF12)>,  
				 <STM32_PINMUX('D', 9, AF12)>,  
				 <STM32_PINMUX('D', 10, AF12)>,  
				 <STM32_PINMUX('G', 9, AF12)>,  
				 <STM32_PINMUX('G', 12, AF12)>;  
			bias-disable;
			drive-push-pull;
			slew-rate = <3>;
		};
	};
	fmc_sleep_pins_b: fmc-sleep-1 {
		pins {
			pinmux = <STM32_PINMUX('D', 4, ANALOG)>,  
				 <STM32_PINMUX('D', 5, ANALOG)>,  
				 <STM32_PINMUX('B', 7, ANALOG)>,  
				 <STM32_PINMUX('D', 14, ANALOG)>,  
				 <STM32_PINMUX('D', 15, ANALOG)>,  
				 <STM32_PINMUX('D', 0, ANALOG)>,  
				 <STM32_PINMUX('D', 1, ANALOG)>,  
				 <STM32_PINMUX('E', 7, ANALOG)>,  
				 <STM32_PINMUX('E', 8, ANALOG)>,  
				 <STM32_PINMUX('E', 9, ANALOG)>,  
				 <STM32_PINMUX('E', 10, ANALOG)>,  
				 <STM32_PINMUX('E', 11, ANALOG)>,  
				 <STM32_PINMUX('E', 12, ANALOG)>,  
				 <STM32_PINMUX('E', 13, ANALOG)>,  
				 <STM32_PINMUX('E', 14, ANALOG)>,  
				 <STM32_PINMUX('E', 15, ANALOG)>,  
				 <STM32_PINMUX('D', 8, ANALOG)>,  
				 <STM32_PINMUX('D', 9, ANALOG)>,  
				 <STM32_PINMUX('D', 10, ANALOG)>,  
				 <STM32_PINMUX('G', 9, ANALOG)>,  
				 <STM32_PINMUX('G', 12, ANALOG)>;  
		};
	};
	i2c1_pins_a: i2c1-0 {
		pins {
			pinmux = <STM32_PINMUX('D', 12, AF5)>,  
				 <STM32_PINMUX('F', 15, AF5)>;  
			bias-disable;
			drive-open-drain;
			slew-rate = <0>;
		};
	};
	i2c1_sleep_pins_a: i2c1-sleep-0 {
		pins {
			pinmux = <STM32_PINMUX('D', 12, ANALOG)>,  
				 <STM32_PINMUX('F', 15, ANALOG)>;  
		};
	};
	i2c1_pins_b: i2c1-1 {
		pins {
			pinmux = <STM32_PINMUX('F', 14, AF5)>,  
				 <STM32_PINMUX('F', 15, AF5)>;  
			bias-disable;
			drive-open-drain;
			slew-rate = <0>;
		};
	};
	i2c1_sleep_pins_b: i2c1-sleep-1 {
		pins {
			pinmux = <STM32_PINMUX('F', 14, ANALOG)>,  
				 <STM32_PINMUX('F', 15, ANALOG)>;  
		};
	};
	i2c2_pins_a: i2c2-0 {
		pins {
			pinmux = <STM32_PINMUX('H', 4, AF4)>,  
				 <STM32_PINMUX('H', 5, AF4)>;  
			bias-disable;
			drive-open-drain;
			slew-rate = <0>;
		};
	};
	i2c2_sleep_pins_a: i2c2-sleep-0 {
		pins {
			pinmux = <STM32_PINMUX('H', 4, ANALOG)>,  
				 <STM32_PINMUX('H', 5, ANALOG)>;  
		};
	};
	i2c2_pins_b1: i2c2-1 {
		pins {
			pinmux = <STM32_PINMUX('H', 5, AF4)>;  
			bias-disable;
			drive-open-drain;
			slew-rate = <0>;
		};
	};
	i2c2_sleep_pins_b1: i2c2-sleep-1 {
		pins {
			pinmux = <STM32_PINMUX('H', 5, ANALOG)>;  
		};
	};
	i2c2_pins_c: i2c2-2 {
		pins {
			pinmux = <STM32_PINMUX('F', 1, AF4)>,  
				 <STM32_PINMUX('H', 5, AF4)>;  
			bias-disable;
			drive-open-drain;
			slew-rate = <0>;
		};
	};
	i2c2_pins_sleep_c: i2c2-sleep-2 {
		pins {
			pinmux = <STM32_PINMUX('F', 1, ANALOG)>,  
				 <STM32_PINMUX('H', 5, ANALOG)>;  
		};
	};
	i2c5_pins_a: i2c5-0 {
		pins {
			pinmux = <STM32_PINMUX('A', 11, AF4)>,  
				 <STM32_PINMUX('A', 12, AF4)>;  
			bias-disable;
			drive-open-drain;
			slew-rate = <0>;
		};
	};
	i2c5_sleep_pins_a: i2c5-sleep-0 {
		pins {
			pinmux = <STM32_PINMUX('A', 11, ANALOG)>,  
				 <STM32_PINMUX('A', 12, ANALOG)>;  
		};
	};
	i2c5_pins_b: i2c5-1 {
		pins {
			pinmux = <STM32_PINMUX('D', 0, AF4)>,  
				 <STM32_PINMUX('D', 1, AF4)>;  
			bias-disable;
			drive-open-drain;
			slew-rate = <0>;
		};
	};
	i2c5_sleep_pins_b: i2c5-sleep-1 {
		pins {
			pinmux = <STM32_PINMUX('D', 0, ANALOG)>,  
				 <STM32_PINMUX('D', 1, ANALOG)>;  
		};
	};
	i2s2_pins_a: i2s2-0 {
		pins {
			pinmux = <STM32_PINMUX('I', 3, AF5)>,  
				 <STM32_PINMUX('B', 9, AF5)>,  
				 <STM32_PINMUX('A', 9, AF5)>;  
			slew-rate = <1>;
			drive-push-pull;
			bias-disable;
		};
	};
	i2s2_sleep_pins_a: i2s2-sleep-0 {
		pins {
			pinmux = <STM32_PINMUX('I', 3, ANALOG)>,  
				 <STM32_PINMUX('B', 9, ANALOG)>,  
				 <STM32_PINMUX('A', 9, ANALOG)>;  
		};
	};
	ltdc_pins_a: ltdc-0 {
		pins {
			pinmux = <STM32_PINMUX('G',  7, AF14)>,  
				 <STM32_PINMUX('I', 10, AF14)>,  
				 <STM32_PINMUX('I',  9, AF14)>,  
				 <STM32_PINMUX('F', 10, AF14)>,  
				 <STM32_PINMUX('H',  2, AF14)>,  
				 <STM32_PINMUX('H',  3, AF14)>,  
				 <STM32_PINMUX('H',  8, AF14)>,  
				 <STM32_PINMUX('H',  9, AF14)>,  
				 <STM32_PINMUX('H', 10, AF14)>,  
				 <STM32_PINMUX('C',  0, AF14)>,  
				 <STM32_PINMUX('H', 12, AF14)>,  
				 <STM32_PINMUX('E', 15, AF14)>,  
				 <STM32_PINMUX('E',  5, AF14)>,  
				 <STM32_PINMUX('E',  6, AF14)>,  
				 <STM32_PINMUX('H', 13, AF14)>,  
				 <STM32_PINMUX('H', 14, AF14)>,  
				 <STM32_PINMUX('H', 15, AF14)>,  
				 <STM32_PINMUX('I',  0, AF14)>,  
				 <STM32_PINMUX('I',  1, AF14)>,  
				 <STM32_PINMUX('I',  2, AF14)>,  
				 <STM32_PINMUX('D',  9, AF14)>,  
				 <STM32_PINMUX('G', 12, AF14)>,  
				 <STM32_PINMUX('G', 10, AF14)>,  
				 <STM32_PINMUX('D', 10, AF14)>,  
				 <STM32_PINMUX('I',  4, AF14)>,  
				 <STM32_PINMUX('A',  3, AF14)>,  
				 <STM32_PINMUX('B',  8, AF14)>,  
				 <STM32_PINMUX('D',  8, AF14)>;  
			bias-disable;
			drive-push-pull;
			slew-rate = <1>;
		};
	};
	ltdc_sleep_pins_a: ltdc-sleep-0 {
		pins {
			pinmux = <STM32_PINMUX('G',  7, ANALOG)>,  
				 <STM32_PINMUX('I', 10, ANALOG)>,  
				 <STM32_PINMUX('I',  9, ANALOG)>,  
				 <STM32_PINMUX('F', 10, ANALOG)>,  
				 <STM32_PINMUX('H',  2, ANALOG)>,  
				 <STM32_PINMUX('H',  3, ANALOG)>,  
				 <STM32_PINMUX('H',  8, ANALOG)>,  
				 <STM32_PINMUX('H',  9, ANALOG)>,  
				 <STM32_PINMUX('H', 10, ANALOG)>,  
				 <STM32_PINMUX('C',  0, ANALOG)>,  
				 <STM32_PINMUX('H', 12, ANALOG)>,  
				 <STM32_PINMUX('E', 15, ANALOG)>,  
				 <STM32_PINMUX('E',  5, ANALOG)>,  
				 <STM32_PINMUX('E',  6, ANALOG)>,  
				 <STM32_PINMUX('H', 13, ANALOG)>,  
				 <STM32_PINMUX('H', 14, ANALOG)>,  
				 <STM32_PINMUX('H', 15, ANALOG)>,  
				 <STM32_PINMUX('I',  0, ANALOG)>,  
				 <STM32_PINMUX('I',  1, ANALOG)>,  
				 <STM32_PINMUX('I',  2, ANALOG)>,  
				 <STM32_PINMUX('D',  9, ANALOG)>,  
				 <STM32_PINMUX('G', 12, ANALOG)>,  
				 <STM32_PINMUX('G', 10, ANALOG)>,  
				 <STM32_PINMUX('D', 10, ANALOG)>,  
				 <STM32_PINMUX('I',  4, ANALOG)>,  
				 <STM32_PINMUX('A',  3, ANALOG)>,  
				 <STM32_PINMUX('B',  8, ANALOG)>,  
				 <STM32_PINMUX('D',  8, ANALOG)>;  
		};
	};
	ltdc_pins_b: ltdc-1 {
		pins {
			pinmux = <STM32_PINMUX('I', 14, AF14)>,  
				 <STM32_PINMUX('I', 12, AF14)>,  
				 <STM32_PINMUX('I', 13, AF14)>,  
				 <STM32_PINMUX('K',  7, AF14)>,  
				 <STM32_PINMUX('I', 15, AF14)>,  
				 <STM32_PINMUX('J',  0, AF14)>,  
				 <STM32_PINMUX('J',  1, AF14)>,  
				 <STM32_PINMUX('J',  2, AF14)>,  
				 <STM32_PINMUX('J',  3, AF14)>,  
				 <STM32_PINMUX('J',  4, AF14)>,  
				 <STM32_PINMUX('J',  5, AF14)>,  
				 <STM32_PINMUX('J',  6, AF14)>,  
				 <STM32_PINMUX('J',  7, AF14)>,  
				 <STM32_PINMUX('J',  8, AF14)>,  
				 <STM32_PINMUX('J',  9, AF14)>,  
				 <STM32_PINMUX('J', 10, AF14)>,  
				 <STM32_PINMUX('J', 11, AF14)>,  
				 <STM32_PINMUX('K',  0, AF14)>,  
				 <STM32_PINMUX('K',  1, AF14)>,  
				 <STM32_PINMUX('K',  2, AF14)>,  
				 <STM32_PINMUX('J', 12, AF14)>,  
				 <STM32_PINMUX('J', 13, AF14)>,  
				 <STM32_PINMUX('J', 14, AF14)>,  
				 <STM32_PINMUX('J', 15, AF14)>,  
				 <STM32_PINMUX('K',  3, AF14)>,  
				 <STM32_PINMUX('K',  4, AF14)>,  
				 <STM32_PINMUX('K',  5, AF14)>,  
				 <STM32_PINMUX('K',  6, AF14)>;  
			bias-disable;
			drive-push-pull;
			slew-rate = <1>;
		};
	};
	ltdc_sleep_pins_b: ltdc-sleep-1 {
		pins {
			pinmux = <STM32_PINMUX('I', 14, ANALOG)>,  
				 <STM32_PINMUX('I', 12, ANALOG)>,  
				 <STM32_PINMUX('I', 13, ANALOG)>,  
				 <STM32_PINMUX('K',  7, ANALOG)>,  
				 <STM32_PINMUX('I', 15, ANALOG)>,  
				 <STM32_PINMUX('J',  0, ANALOG)>,  
				 <STM32_PINMUX('J',  1, ANALOG)>,  
				 <STM32_PINMUX('J',  2, ANALOG)>,  
				 <STM32_PINMUX('J',  3, ANALOG)>,  
				 <STM32_PINMUX('J',  4, ANALOG)>,  
				 <STM32_PINMUX('J',  5, ANALOG)>,  
				 <STM32_PINMUX('J',  6, ANALOG)>,  
				 <STM32_PINMUX('J',  7, ANALOG)>,  
				 <STM32_PINMUX('J',  8, ANALOG)>,  
				 <STM32_PINMUX('J',  9, ANALOG)>,  
				 <STM32_PINMUX('J', 10, ANALOG)>,  
				 <STM32_PINMUX('J', 11, ANALOG)>,  
				 <STM32_PINMUX('K',  0, ANALOG)>,  
				 <STM32_PINMUX('K',  1, ANALOG)>,  
				 <STM32_PINMUX('K',  2, ANALOG)>,  
				 <STM32_PINMUX('J', 12, ANALOG)>,  
				 <STM32_PINMUX('J', 13, ANALOG)>,  
				 <STM32_PINMUX('J', 14, ANALOG)>,  
				 <STM32_PINMUX('J', 15, ANALOG)>,  
				 <STM32_PINMUX('K',  3, ANALOG)>,  
				 <STM32_PINMUX('K',  4, ANALOG)>,  
				 <STM32_PINMUX('K',  5, ANALOG)>,  
				 <STM32_PINMUX('K',  6, ANALOG)>;  
		};
	};
	ltdc_pins_c: ltdc-2 {
		pins1 {
			pinmux = <STM32_PINMUX('B',  1, AF9)>,   
				 <STM32_PINMUX('B',  9, AF14)>,  
				 <STM32_PINMUX('C',  0, AF14)>,  
				 <STM32_PINMUX('D',  3, AF14)>,  
				 <STM32_PINMUX('D',  6, AF14)>,  
				 <STM32_PINMUX('D', 10, AF14)>,  
				 <STM32_PINMUX('E', 11, AF14)>,  
				 <STM32_PINMUX('E', 12, AF14)>,  
				 <STM32_PINMUX('E', 13, AF14)>,  
				 <STM32_PINMUX('E', 15, AF14)>,  
				 <STM32_PINMUX('H',  4, AF9)>,   
				 <STM32_PINMUX('H',  8, AF14)>,  
				 <STM32_PINMUX('H',  9, AF14)>,  
				 <STM32_PINMUX('H', 10, AF14)>,  
				 <STM32_PINMUX('H', 13, AF14)>,  
				 <STM32_PINMUX('H', 15, AF14)>,  
				 <STM32_PINMUX('I',  1, AF14)>,  
				 <STM32_PINMUX('I',  5, AF14)>,  
				 <STM32_PINMUX('I',  6, AF14)>,  
				 <STM32_PINMUX('I',  9, AF14)>,  
				 <STM32_PINMUX('I', 10, AF14)>;  
			bias-disable;
			drive-push-pull;
			slew-rate = <0>;
		};
		pins2 {
			pinmux = <STM32_PINMUX('E', 14, AF14)>;  
			bias-disable;
			drive-push-pull;
			slew-rate = <1>;
		};
	};
	ltdc_sleep_pins_c: ltdc-sleep-2 {
		pins1 {
			pinmux = <STM32_PINMUX('B', 1, ANALOG)>,   
				 <STM32_PINMUX('B', 9, ANALOG)>,  
				 <STM32_PINMUX('C', 0, ANALOG)>,  
				 <STM32_PINMUX('D', 3, ANALOG)>,  
				 <STM32_PINMUX('D', 6, ANALOG)>,  
				 <STM32_PINMUX('D', 10, ANALOG)>,  
				 <STM32_PINMUX('E', 11, ANALOG)>,  
				 <STM32_PINMUX('E', 12, ANALOG)>,  
				 <STM32_PINMUX('E', 13, ANALOG)>,  
				 <STM32_PINMUX('E', 15, ANALOG)>,  
				 <STM32_PINMUX('H', 4, ANALOG)>,   
				 <STM32_PINMUX('H', 8, ANALOG)>,  
				 <STM32_PINMUX('H', 9, ANALOG)>,  
				 <STM32_PINMUX('H', 10, ANALOG)>,  
				 <STM32_PINMUX('H', 13, ANALOG)>,  
				 <STM32_PINMUX('H', 15, ANALOG)>,  
				 <STM32_PINMUX('I', 1, ANALOG)>,  
				 <STM32_PINMUX('I', 5, ANALOG)>,  
				 <STM32_PINMUX('I', 6, ANALOG)>,  
				 <STM32_PINMUX('I', 9, ANALOG)>,  
				 <STM32_PINMUX('I', 10, ANALOG)>,  
				 <STM32_PINMUX('E', 14, ANALOG)>;  
		};
	};
	ltdc_pins_d: ltdc-3 {
		pins1 {
			pinmux = <STM32_PINMUX('G',  7, AF14)>;  
			bias-disable;
			drive-push-pull;
			slew-rate = <3>;
		};
		pins2 {
			pinmux = <STM32_PINMUX('I', 10, AF14)>,  
				 <STM32_PINMUX('I',  9, AF14)>,  
				 <STM32_PINMUX('E', 13, AF14)>,  
				 <STM32_PINMUX('G', 13, AF14)>,  
				 <STM32_PINMUX('H',  3, AF14)>,  
				 <STM32_PINMUX('H',  8, AF14)>,  
				 <STM32_PINMUX('H',  9, AF14)>,  
				 <STM32_PINMUX('A',  5, AF14)>,  
				 <STM32_PINMUX('H', 11, AF14)>,  
				 <STM32_PINMUX('H', 12, AF14)>,  
				 <STM32_PINMUX('E', 15, AF14)>,  
				 <STM32_PINMUX('E',  5, AF14)>,  
				 <STM32_PINMUX('B',  0, AF14)>,  
				 <STM32_PINMUX('H', 13, AF14)>,  
				 <STM32_PINMUX('E', 11, AF14)>,  
				 <STM32_PINMUX('H', 15, AF14)>,  
				 <STM32_PINMUX('H',  4,  AF9)>,  
				 <STM32_PINMUX('I', 11,  AF9)>,  
				 <STM32_PINMUX('G',  8, AF14)>,  
				 <STM32_PINMUX('D',  9, AF14)>,  
				 <STM32_PINMUX('G', 12, AF14)>,  
				 <STM32_PINMUX('G', 10, AF14)>,  
				 <STM32_PINMUX('D', 10, AF14)>,  
				 <STM32_PINMUX('E', 12, AF14)>,  
				 <STM32_PINMUX('A',  3, AF14)>,  
				 <STM32_PINMUX('B',  8, AF14)>,  
				 <STM32_PINMUX('I',  7, AF14)>;  
			bias-disable;
			drive-push-pull;
			slew-rate = <2>;
		};
	};
	ltdc_sleep_pins_d: ltdc-sleep-3 {
		pins {
			pinmux = <STM32_PINMUX('G',  7, ANALOG)>,  
				 <STM32_PINMUX('I', 10, ANALOG)>,  
				 <STM32_PINMUX('I',  9, ANALOG)>,  
				 <STM32_PINMUX('E', 13, ANALOG)>,  
				 <STM32_PINMUX('G', 13, ANALOG)>,  
				 <STM32_PINMUX('H',  3, ANALOG)>,  
				 <STM32_PINMUX('H',  8, ANALOG)>,  
				 <STM32_PINMUX('H',  9, ANALOG)>,  
				 <STM32_PINMUX('A',  5, ANALOG)>,  
				 <STM32_PINMUX('H', 11, ANALOG)>,  
				 <STM32_PINMUX('H', 12, ANALOG)>,  
				 <STM32_PINMUX('E', 15, ANALOG)>,  
				 <STM32_PINMUX('E',  5, ANALOG)>,  
				 <STM32_PINMUX('B',  0, ANALOG)>,  
				 <STM32_PINMUX('H', 13, ANALOG)>,  
				 <STM32_PINMUX('E', 11, ANALOG)>,  
				 <STM32_PINMUX('H', 15, ANALOG)>,  
				 <STM32_PINMUX('H',  4, ANALOG)>,  
				 <STM32_PINMUX('I', 11, ANALOG)>,  
				 <STM32_PINMUX('G',  8, ANALOG)>,  
				 <STM32_PINMUX('D',  9, ANALOG)>,  
				 <STM32_PINMUX('G', 12, ANALOG)>,  
				 <STM32_PINMUX('G', 10, ANALOG)>,  
				 <STM32_PINMUX('D', 10, ANALOG)>,  
				 <STM32_PINMUX('E', 12, ANALOG)>,  
				 <STM32_PINMUX('A',  3, ANALOG)>,  
				 <STM32_PINMUX('B',  8, ANALOG)>,  
				 <STM32_PINMUX('I',  7, ANALOG)>;  
		};
	};
	mco1_pins_a: mco1-0 {
		pins {
			pinmux = <STM32_PINMUX('A', 13, AF2)>;  
			bias-disable;
			drive-push-pull;
			slew-rate = <1>;
		};
	};
	mco1_sleep_pins_a: mco1-sleep-0 {
		pins {
			pinmux = <STM32_PINMUX('A', 13, ANALOG)>;  
		};
	};
	mco2_pins_a: mco2-0 {
		pins {
			pinmux = <STM32_PINMUX('G', 2, AF1)>;  
			bias-disable;
			drive-push-pull;
			slew-rate = <2>;
		};
	};
	mco2_sleep_pins_a: mco2-sleep-0 {
		pins {
			pinmux = <STM32_PINMUX('G', 2, ANALOG)>;  
		};
	};
	m_can1_pins_a: m-can1-0 {
		pins1 {
			pinmux = <STM32_PINMUX('H', 13, AF9)>;  
			slew-rate = <1>;
			drive-push-pull;
			bias-disable;
		};
		pins2 {
			pinmux = <STM32_PINMUX('I', 9, AF9)>;  
			bias-disable;
		};
	};
	m_can1_sleep_pins_a: m_can1-sleep-0 {
		pins {
			pinmux = <STM32_PINMUX('H', 13, ANALOG)>,  
				 <STM32_PINMUX('I', 9, ANALOG)>;  
		};
	};
	m_can1_pins_b: m-can1-1 {
		pins1 {
			pinmux = <STM32_PINMUX('A', 12, AF9)>;  
			slew-rate = <1>;
			drive-push-pull;
			bias-disable;
		};
		pins2 {
			pinmux = <STM32_PINMUX('A', 11, AF9)>;  
			bias-disable;
		};
	};
	m_can1_sleep_pins_b: m_can1-sleep-1 {
		pins {
			pinmux = <STM32_PINMUX('A', 12, ANALOG)>,  
				 <STM32_PINMUX('A', 11, ANALOG)>;  
		};
	};
	m_can1_pins_c: m-can1-2 {
		pins1 {
			pinmux = <STM32_PINMUX('H', 13, AF9)>;  
			slew-rate = <1>;
			drive-push-pull;
			bias-disable;
		};
		pins2 {
			pinmux = <STM32_PINMUX('H', 14, AF9)>;  
			bias-disable;
		};
	};
	m_can1_sleep_pins_c: m_can1-sleep-2 {
		pins {
			pinmux = <STM32_PINMUX('H', 13, ANALOG)>,  
				 <STM32_PINMUX('H', 14, ANALOG)>;  
		};
	};
	m_can2_pins_a: m-can2-0 {
		pins1 {
			pinmux = <STM32_PINMUX('B', 13, AF9)>;  
			slew-rate = <1>;
			drive-push-pull;
			bias-disable;
		};
		pins2 {
			pinmux = <STM32_PINMUX('B', 5, AF9)>;  
			bias-disable;
		};
	};
	m_can2_sleep_pins_a: m_can2-sleep-0 {
		pins {
			pinmux = <STM32_PINMUX('B', 13, ANALOG)>,  
				 <STM32_PINMUX('B', 5, ANALOG)>;  
		};
	};
	pwm1_pins_a: pwm1-0 {
		pins {
			pinmux = <STM32_PINMUX('E', 9, AF1)>,  
				 <STM32_PINMUX('E', 11, AF1)>,  
				 <STM32_PINMUX('E', 14, AF1)>;  
			bias-pull-down;
			drive-push-pull;
			slew-rate = <0>;
		};
	};
	pwm1_sleep_pins_a: pwm1-sleep-0 {
		pins {
			pinmux = <STM32_PINMUX('E', 9, ANALOG)>,  
				 <STM32_PINMUX('E', 11, ANALOG)>,  
				 <STM32_PINMUX('E', 14, ANALOG)>;  
		};
	};
	pwm1_pins_b: pwm1-1 {
		pins {
			pinmux = <STM32_PINMUX('E', 9, AF1)>;  
			bias-pull-down;
			drive-push-pull;
			slew-rate = <0>;
		};
	};
	pwm1_sleep_pins_b: pwm1-sleep-1 {
		pins {
			pinmux = <STM32_PINMUX('E', 9, ANALOG)>;  
		};
	};
	pwm1_pins_c: pwm1-2 {
		pins {
			pinmux = <STM32_PINMUX('E', 11, AF1)>;  
			drive-push-pull;
			slew-rate = <0>;
		};
	};
	pwm1_sleep_pins_c: pwm1-sleep-2 {
		pins {
			pinmux = <STM32_PINMUX('E', 11, ANALOG)>;  
		};
	};
	pwm2_pins_a: pwm2-0 {
		pins {
			pinmux = <STM32_PINMUX('A', 3, AF1)>;  
			bias-pull-down;
			drive-push-pull;
			slew-rate = <0>;
		};
	};
	pwm2_sleep_pins_a: pwm2-sleep-0 {
		pins {
			pinmux = <STM32_PINMUX('A', 3, ANALOG)>;  
		};
	};
	pwm3_pins_a: pwm3-0 {
		pins {
			pinmux = <STM32_PINMUX('C', 7, AF2)>;  
			bias-pull-down;
			drive-push-pull;
			slew-rate = <0>;
		};
	};
	pwm3_sleep_pins_a: pwm3-sleep-0 {
		pins {
			pinmux = <STM32_PINMUX('C', 7, ANALOG)>;  
		};
	};
	pwm3_pins_b: pwm3-1 {
		pins {
			pinmux = <STM32_PINMUX('B', 5, AF2)>;  
			bias-disable;
			drive-push-pull;
			slew-rate = <0>;
		};
	};
	pwm3_sleep_pins_b: pwm3-sleep-1 {
		pins {
			pinmux = <STM32_PINMUX('B', 5, ANALOG)>;  
		};
	};
	pwm4_pins_a: pwm4-0 {
		pins {
			pinmux = <STM32_PINMUX('D', 14, AF2)>,  
				 <STM32_PINMUX('D', 15, AF2)>;  
			bias-pull-down;
			drive-push-pull;
			slew-rate = <0>;
		};
	};
	pwm4_sleep_pins_a: pwm4-sleep-0 {
		pins {
			pinmux = <STM32_PINMUX('D', 14, ANALOG)>,  
				 <STM32_PINMUX('D', 15, ANALOG)>;  
		};
	};
	pwm4_pins_b: pwm4-1 {
		pins {
			pinmux = <STM32_PINMUX('D', 13, AF2)>;  
			bias-pull-down;
			drive-push-pull;
			slew-rate = <0>;
		};
	};
	pwm4_sleep_pins_b: pwm4-sleep-1 {
		pins {
			pinmux = <STM32_PINMUX('D', 13, ANALOG)>;  
		};
	};
	pwm5_pins_a: pwm5-0 {
		pins {
			pinmux = <STM32_PINMUX('H', 11, AF2)>;  
			bias-pull-down;
			drive-push-pull;
			slew-rate = <0>;
		};
	};
	pwm5_sleep_pins_a: pwm5-sleep-0 {
		pins {
			pinmux = <STM32_PINMUX('H', 11, ANALOG)>;  
		};
	};
	pwm5_pins_b: pwm5-1 {
		pins {
			pinmux = <STM32_PINMUX('H', 11, AF2)>,  
				 <STM32_PINMUX('H', 12, AF2)>,  
				 <STM32_PINMUX('I', 0, AF2)>;  
			bias-disable;
			drive-push-pull;
			slew-rate = <0>;
		};
	};
	pwm5_sleep_pins_b: pwm5-sleep-1 {
		pins {
			pinmux = <STM32_PINMUX('H', 11, ANALOG)>,  
				 <STM32_PINMUX('H', 12, ANALOG)>,  
				 <STM32_PINMUX('I', 0, ANALOG)>;  
		};
	};
	pwm8_pins_a: pwm8-0 {
		pins {
			pinmux = <STM32_PINMUX('I', 2, AF3)>;  
			bias-pull-down;
			drive-push-pull;
			slew-rate = <0>;
		};
	};
	pwm8_sleep_pins_a: pwm8-sleep-0 {
		pins {
			pinmux = <STM32_PINMUX('I', 2, ANALOG)>;  
		};
	};
	pwm8_pins_b: pwm8-1 {
		pins {
			pinmux = <STM32_PINMUX('I', 5, AF3)>,  
				 <STM32_PINMUX('I', 6, AF3)>,  
				 <STM32_PINMUX('I', 7, AF3)>,  
				 <STM32_PINMUX('C', 9, AF3)>;  
			drive-push-pull;
			slew-rate = <0>;
		};
	};
	pwm8_sleep_pins_b: pwm8-sleep-1 {
		pins {
			pinmux = <STM32_PINMUX('I', 5, ANALOG)>,  
				 <STM32_PINMUX('I', 6, ANALOG)>,  
				 <STM32_PINMUX('I', 7, ANALOG)>,  
				 <STM32_PINMUX('C', 9, ANALOG)>;  
		};
	};
	pwm12_pins_a: pwm12-0 {
		pins {
			pinmux = <STM32_PINMUX('H', 6, AF2)>;  
			bias-pull-down;
			drive-push-pull;
			slew-rate = <0>;
		};
	};
	pwm12_sleep_pins_a: pwm12-sleep-0 {
		pins {
			pinmux = <STM32_PINMUX('H', 6, ANALOG)>;  
		};
	};
	qspi_clk_pins_a: qspi-clk-0 {
		pins {
			pinmux = <STM32_PINMUX('F', 10, AF9)>;  
			bias-disable;
			drive-push-pull;
			slew-rate = <3>;
		};
	};
	qspi_clk_sleep_pins_a: qspi-clk-sleep-0 {
		pins {
			pinmux = <STM32_PINMUX('F', 10, ANALOG)>;  
		};
	};
	qspi_bk1_pins_a: qspi-bk1-0 {
		pins {
			pinmux = <STM32_PINMUX('F', 8, AF10)>,  
				 <STM32_PINMUX('F', 9, AF10)>,  
				 <STM32_PINMUX('F', 7, AF9)>,  
				 <STM32_PINMUX('F', 6, AF9)>;  
			bias-disable;
			drive-push-pull;
			slew-rate = <1>;
		};
	};
	qspi_bk1_sleep_pins_a: qspi-bk1-sleep-0 {
		pins {
			pinmux = <STM32_PINMUX('F', 8, ANALOG)>,  
				 <STM32_PINMUX('F', 9, ANALOG)>,  
				 <STM32_PINMUX('F', 7, ANALOG)>,  
				 <STM32_PINMUX('F', 6, ANALOG)>;  
		};
	};
	qspi_bk2_pins_a: qspi-bk2-0 {
		pins {
			pinmux = <STM32_PINMUX('H', 2, AF9)>,  
				 <STM32_PINMUX('H', 3, AF9)>,  
				 <STM32_PINMUX('G', 10, AF11)>,  
				 <STM32_PINMUX('G', 7, AF11)>;  
			bias-disable;
			drive-push-pull;
			slew-rate = <1>;
		};
	};
	qspi_bk2_sleep_pins_a: qspi-bk2-sleep-0 {
		pins {
			pinmux = <STM32_PINMUX('H', 2, ANALOG)>,  
				 <STM32_PINMUX('H', 3, ANALOG)>,  
				 <STM32_PINMUX('G', 10, ANALOG)>,  
				 <STM32_PINMUX('G', 7, ANALOG)>;  
		};
	};
	qspi_cs1_pins_a: qspi-cs1-0 {
		pins {
			pinmux = <STM32_PINMUX('B', 6, AF10)>;  
			bias-pull-up;
			drive-push-pull;
			slew-rate = <1>;
		};
	};
	qspi_cs1_sleep_pins_a: qspi-cs1-sleep-0 {
		pins {
			pinmux = <STM32_PINMUX('B', 6, ANALOG)>;  
		};
	};
	qspi_cs2_pins_a: qspi-cs2-0 {
		pins {
			pinmux = <STM32_PINMUX('C', 0, AF10)>;  
			bias-pull-up;
			drive-push-pull;
			slew-rate = <1>;
		};
	};
	qspi_cs2_sleep_pins_a: qspi-cs2-sleep-0 {
		pins {
			pinmux = <STM32_PINMUX('C', 0, ANALOG)>;  
		};
	};
	sai2a_pins_a: sai2a-0 {
		pins {
			pinmux = <STM32_PINMUX('I', 5, AF10)>,  
				 <STM32_PINMUX('I', 6, AF10)>,  
				 <STM32_PINMUX('I', 7, AF10)>,  
				 <STM32_PINMUX('E', 0, AF10)>;  
			slew-rate = <0>;
			drive-push-pull;
			bias-disable;
		};
	};
	sai2a_sleep_pins_a: sai2a-sleep-0 {
		pins {
			pinmux = <STM32_PINMUX('I', 5, ANALOG)>,  
				 <STM32_PINMUX('I', 6, ANALOG)>,  
				 <STM32_PINMUX('I', 7, ANALOG)>,  
				 <STM32_PINMUX('E', 0, ANALOG)>;  
		};
	};
	sai2a_pins_b: sai2a-1 {
		pins1 {
			pinmux = <STM32_PINMUX('I', 6, AF10)>,	 
				 <STM32_PINMUX('I', 7, AF10)>,	 
				 <STM32_PINMUX('D', 13, AF10)>;	 
			slew-rate = <0>;
			drive-push-pull;
			bias-disable;
		};
	};
	sai2a_sleep_pins_b: sai2a-sleep-1 {
		pins {
			pinmux = <STM32_PINMUX('I', 6, ANALOG)>,   
				 <STM32_PINMUX('I', 7, ANALOG)>,   
				 <STM32_PINMUX('D', 13, ANALOG)>;  
		};
	};
	sai2a_pins_c: sai2a-2 {
		pins {
			pinmux = <STM32_PINMUX('D', 13, AF10)>,  
				 <STM32_PINMUX('D', 11, AF10)>,  
				 <STM32_PINMUX('D', 12, AF10)>;  
			slew-rate = <0>;
			drive-push-pull;
			bias-disable;
		};
	};
	sai2a_sleep_pins_c: sai2a-sleep-2 {
		pins {
			pinmux = <STM32_PINMUX('D', 13, ANALOG)>,  
				 <STM32_PINMUX('D', 11, ANALOG)>,  
				 <STM32_PINMUX('D', 12, ANALOG)>;  
		};
	};
	sai2b_pins_a: sai2b-0 {
		pins1 {
			pinmux = <STM32_PINMUX('E', 12, AF10)>,  
				 <STM32_PINMUX('E', 13, AF10)>,  
				 <STM32_PINMUX('E', 14, AF10)>;  
			slew-rate = <0>;
			drive-push-pull;
			bias-disable;
		};
		pins2 {
			pinmux = <STM32_PINMUX('F', 11, AF10)>;  
			bias-disable;
		};
	};
	sai2b_sleep_pins_a: sai2b-sleep-0 {
		pins {
			pinmux = <STM32_PINMUX('F', 11, ANALOG)>,  
				 <STM32_PINMUX('E', 12, ANALOG)>,  
				 <STM32_PINMUX('E', 13, ANALOG)>,  
				 <STM32_PINMUX('E', 14, ANALOG)>;  
		};
	};
	sai2b_pins_b: sai2b-1 {
		pins {
			pinmux = <STM32_PINMUX('F', 11, AF10)>;  
			bias-disable;
		};
	};
	sai2b_sleep_pins_b: sai2b-sleep-1 {
		pins {
			pinmux = <STM32_PINMUX('F', 11, ANALOG)>;  
		};
	};
	sai2b_pins_c: sai2b-2 {
		pins1 {
			pinmux = <STM32_PINMUX('F', 11, AF10)>;  
			bias-disable;
		};
	};
	sai2b_sleep_pins_c: sai2b-sleep-2 {
		pins {
			pinmux = <STM32_PINMUX('F', 11, ANALOG)>;  
		};
	};
	sai2b_pins_d: sai2b-3 {
		pins1 {
			pinmux = <STM32_PINMUX('H', 2, AF10)>,  
				 <STM32_PINMUX('C', 0, AF8)>,  
				 <STM32_PINMUX('H', 3, AF10)>;  
			slew-rate = <0>;
			drive-push-pull;
			bias-disable;
		};
		pins2 {
			pinmux = <STM32_PINMUX('F', 11, AF10)>;  
			bias-disable;
		};
	};
	sai2b_sleep_pins_d: sai2b-sleep-3 {
		pins1 {
			pinmux = <STM32_PINMUX('H', 2, ANALOG)>,  
				 <STM32_PINMUX('C', 0, ANALOG)>,  
				 <STM32_PINMUX('H', 3, ANALOG)>,  
				 <STM32_PINMUX('F', 11, ANALOG)>;  
		};
	};
	sai4a_pins_a: sai4a-0 {
		pins {
			pinmux = <STM32_PINMUX('B', 5, AF10)>;  
			slew-rate = <0>;
			drive-push-pull;
			bias-disable;
		};
	};
	sai4a_sleep_pins_a: sai4a-sleep-0 {
		pins {
			pinmux = <STM32_PINMUX('B', 5, ANALOG)>;  
		};
	};
	sdmmc1_b4_pins_a: sdmmc1-b4-0 {
		pins1 {
			pinmux = <STM32_PINMUX('C', 8, AF12)>,  
				 <STM32_PINMUX('C', 9, AF12)>,  
				 <STM32_PINMUX('C', 10, AF12)>,  
				 <STM32_PINMUX('C', 11, AF12)>,  
				 <STM32_PINMUX('D', 2, AF12)>;  
			slew-rate = <1>;
			drive-push-pull;
			bias-disable;
		};
		pins2 {
			pinmux = <STM32_PINMUX('C', 12, AF12)>;  
			slew-rate = <2>;
			drive-push-pull;
			bias-disable;
		};
	};
	sdmmc1_b4_od_pins_a: sdmmc1-b4-od-0 {
		pins1 {
			pinmux = <STM32_PINMUX('C', 8, AF12)>,  
				 <STM32_PINMUX('C', 9, AF12)>,  
				 <STM32_PINMUX('C', 10, AF12)>,  
				 <STM32_PINMUX('C', 11, AF12)>;  
			slew-rate = <1>;
			drive-push-pull;
			bias-disable;
		};
		pins2 {
			pinmux = <STM32_PINMUX('C', 12, AF12)>;  
			slew-rate = <2>;
			drive-push-pull;
			bias-disable;
		};
		pins3 {
			pinmux = <STM32_PINMUX('D', 2, AF12)>;  
			slew-rate = <1>;
			drive-open-drain;
			bias-disable;
		};
	};
	sdmmc1_b4_init_pins_a: sdmmc1-b4-init-0 {
		pins1 {
			pinmux = <STM32_PINMUX('C', 8, AF12)>,  
				 <STM32_PINMUX('C', 9, AF12)>,  
				 <STM32_PINMUX('C', 10, AF12)>,  
				 <STM32_PINMUX('C', 11, AF12)>;  
			slew-rate = <1>;
			drive-push-pull;
			bias-disable;
		};
	};
	sdmmc1_b4_sleep_pins_a: sdmmc1-b4-sleep-0 {
		pins {
			pinmux = <STM32_PINMUX('C', 8, ANALOG)>,  
				 <STM32_PINMUX('C', 9, ANALOG)>,  
				 <STM32_PINMUX('C', 10, ANALOG)>,  
				 <STM32_PINMUX('C', 11, ANALOG)>,  
				 <STM32_PINMUX('C', 12, ANALOG)>,  
				 <STM32_PINMUX('D', 2, ANALOG)>;  
		};
	};
	sdmmc1_b4_pins_b: sdmmc1-b4-1 {
		pins1 {
			pinmux = <STM32_PINMUX('C', 8, AF12)>,  
				 <STM32_PINMUX('C', 9, AF12)>,  
				 <STM32_PINMUX('E', 6, AF8)>,  
				 <STM32_PINMUX('C', 11, AF12)>,  
				 <STM32_PINMUX('D', 2, AF12)>;  
			slew-rate = <1>;
			drive-push-pull;
			bias-disable;
		};
		pins2 {
			pinmux = <STM32_PINMUX('C', 12, AF12)>;  
			slew-rate = <2>;
			drive-push-pull;
			bias-disable;
		};
	};
	sdmmc1_b4_od_pins_b: sdmmc1-b4-od-1 {
		pins1 {
			pinmux = <STM32_PINMUX('C', 8, AF12)>,  
				 <STM32_PINMUX('C', 9, AF12)>,  
				 <STM32_PINMUX('E', 6, AF8)>,  
				 <STM32_PINMUX('C', 11, AF12)>;  
			slew-rate = <1>;
			drive-push-pull;
			bias-disable;
		};
		pins2 {
			pinmux = <STM32_PINMUX('C', 12, AF12)>;  
			slew-rate = <2>;
			drive-push-pull;
			bias-disable;
		};
		pins3 {
			pinmux = <STM32_PINMUX('D', 2, AF12)>;  
			slew-rate = <1>;
			drive-open-drain;
			bias-disable;
		};
	};
	sdmmc1_b4_sleep_pins_b: sdmmc1-b4-sleep-1 {
		pins {
			pinmux = <STM32_PINMUX('C', 8, ANALOG)>,  
				 <STM32_PINMUX('C', 9, ANALOG)>,  
				 <STM32_PINMUX('E', 6, ANALOG)>,  
				 <STM32_PINMUX('C', 11, ANALOG)>,  
				 <STM32_PINMUX('C', 12, ANALOG)>,  
				 <STM32_PINMUX('D', 2, ANALOG)>;  
		};
	};
	sdmmc1_dir_pins_a: sdmmc1-dir-0 {
		pins1 {
			pinmux = <STM32_PINMUX('F', 2, AF11)>,  
				 <STM32_PINMUX('C', 7, AF8)>,  
				 <STM32_PINMUX('B', 9, AF11)>;  
			slew-rate = <1>;
			drive-push-pull;
			bias-pull-up;
		};
		pins2 {
			pinmux = <STM32_PINMUX('E', 4, AF8)>;  
			bias-pull-up;
		};
	};
	sdmmc1_dir_init_pins_a: sdmmc1-dir-init-0 {
		pins1 {
			pinmux = <STM32_PINMUX('F', 2, AF11)>,  
				 <STM32_PINMUX('C', 7, AF8)>,  
				 <STM32_PINMUX('B', 9, AF11)>;  
			slew-rate = <1>;
			drive-push-pull;
			bias-pull-up;
		};
	};
	sdmmc1_dir_sleep_pins_a: sdmmc1-dir-sleep-0 {
		pins {
			pinmux = <STM32_PINMUX('F', 2, ANALOG)>,  
				 <STM32_PINMUX('C', 7, ANALOG)>,  
				 <STM32_PINMUX('B', 9, ANALOG)>,  
				 <STM32_PINMUX('E', 4, ANALOG)>;  
		};
	};
	sdmmc1_dir_pins_b: sdmmc1-dir-1 {
		pins1 {
			pinmux = <STM32_PINMUX('F', 2, AF11)>,  
				 <STM32_PINMUX('E', 14, AF11)>,  
				 <STM32_PINMUX('B', 9, AF11)>;  
			slew-rate = <1>;
			drive-push-pull;
			bias-pull-up;
		};
		pins2 {
			pinmux = <STM32_PINMUX('E', 4, AF8)>;  
			bias-pull-up;
		};
	};
	sdmmc1_dir_sleep_pins_b: sdmmc1-dir-sleep-1 {
		pins {
			pinmux = <STM32_PINMUX('F', 2, ANALOG)>,  
				 <STM32_PINMUX('E', 14, ANALOG)>,  
				 <STM32_PINMUX('B', 9, ANALOG)>,  
				 <STM32_PINMUX('E', 4, ANALOG)>;  
		};
	};
	sdmmc2_b4_pins_a: sdmmc2-b4-0 {
		pins1 {
			pinmux = <STM32_PINMUX('B', 14, AF9)>,  
				 <STM32_PINMUX('B', 15, AF9)>,  
				 <STM32_PINMUX('B', 3, AF9)>,  
				 <STM32_PINMUX('B', 4, AF9)>,  
				 <STM32_PINMUX('G', 6, AF10)>;  
			slew-rate = <1>;
			drive-push-pull;
			bias-pull-up;
		};
		pins2 {
			pinmux = <STM32_PINMUX('E', 3, AF9)>;  
			slew-rate = <2>;
			drive-push-pull;
			bias-pull-up;
		};
	};
	sdmmc2_b4_od_pins_a: sdmmc2-b4-od-0 {
		pins1 {
			pinmux = <STM32_PINMUX('B', 14, AF9)>,  
				 <STM32_PINMUX('B', 15, AF9)>,  
				 <STM32_PINMUX('B', 3, AF9)>,  
				 <STM32_PINMUX('B', 4, AF9)>;  
			slew-rate = <1>;
			drive-push-pull;
			bias-pull-up;
		};
		pins2 {
			pinmux = <STM32_PINMUX('E', 3, AF9)>;  
			slew-rate = <2>;
			drive-push-pull;
			bias-pull-up;
		};
		pins3 {
			pinmux = <STM32_PINMUX('G', 6, AF10)>;  
			slew-rate = <1>;
			drive-open-drain;
			bias-pull-up;
		};
	};
	sdmmc2_b4_sleep_pins_a: sdmmc2-b4-sleep-0 {
		pins {
			pinmux = <STM32_PINMUX('B', 14, ANALOG)>,  
				 <STM32_PINMUX('B', 15, ANALOG)>,  
				 <STM32_PINMUX('B', 3, ANALOG)>,  
				 <STM32_PINMUX('B', 4, ANALOG)>,  
				 <STM32_PINMUX('E', 3, ANALOG)>,  
				 <STM32_PINMUX('G', 6, ANALOG)>;  
		};
	};
	sdmmc2_b4_pins_b: sdmmc2-b4-1 {
		pins1 {
			pinmux = <STM32_PINMUX('B', 14, AF9)>,  
				 <STM32_PINMUX('B', 15, AF9)>,  
				 <STM32_PINMUX('B', 3, AF9)>,  
				 <STM32_PINMUX('B', 4, AF9)>,  
				 <STM32_PINMUX('G', 6, AF10)>;  
			slew-rate = <1>;
			drive-push-pull;
			bias-disable;
		};
		pins2 {
			pinmux = <STM32_PINMUX('E', 3, AF9)>;  
			slew-rate = <2>;
			drive-push-pull;
			bias-disable;
		};
	};
	sdmmc2_b4_od_pins_b: sdmmc2-b4-od-1 {
		pins1 {
			pinmux = <STM32_PINMUX('B', 14, AF9)>,  
				 <STM32_PINMUX('B', 15, AF9)>,  
				 <STM32_PINMUX('B', 3, AF9)>,  
				 <STM32_PINMUX('B', 4, AF9)>;  
			slew-rate = <1>;
			drive-push-pull;
			bias-disable;
		};
		pins2 {
			pinmux = <STM32_PINMUX('E', 3, AF9)>;  
			slew-rate = <2>;
			drive-push-pull;
			bias-disable;
		};
		pins3 {
			pinmux = <STM32_PINMUX('G', 6, AF10)>;  
			slew-rate = <1>;
			drive-open-drain;
			bias-disable;
		};
	};
	sdmmc2_d47_pins_a: sdmmc2-d47-0 {
		pins {
			pinmux = <STM32_PINMUX('A', 8, AF9)>,  
				 <STM32_PINMUX('A', 9, AF10)>,  
				 <STM32_PINMUX('E', 5, AF9)>,  
				 <STM32_PINMUX('D', 3, AF9)>;  
			slew-rate = <1>;
			drive-push-pull;
			bias-pull-up;
		};
	};
	sdmmc2_d47_sleep_pins_a: sdmmc2-d47-sleep-0 {
		pins {
			pinmux = <STM32_PINMUX('A', 8, ANALOG)>,  
				 <STM32_PINMUX('A', 9, ANALOG)>,  
				 <STM32_PINMUX('E', 5, ANALOG)>,  
				 <STM32_PINMUX('D', 3, ANALOG)>;  
		};
	};
	sdmmc2_d47_pins_b: sdmmc2-d47-1 {
		pins {
			pinmux = <STM32_PINMUX('A', 8, AF9)>,   
				 <STM32_PINMUX('A', 9, AF10)>,  
				 <STM32_PINMUX('C', 6, AF10)>,  
				 <STM32_PINMUX('C', 7, AF10)>;  
			slew-rate = <1>;
			drive-push-pull;
			bias-disable;
		};
	};
	sdmmc2_d47_sleep_pins_b: sdmmc2-d47-sleep-1 {
		pins {
			pinmux = <STM32_PINMUX('A', 8, ANALOG)>,  
				 <STM32_PINMUX('A', 9, ANALOG)>,  
				 <STM32_PINMUX('C', 6, ANALOG)>,  
				 <STM32_PINMUX('C', 7, ANALOG)>;  
		};
	};
	sdmmc2_d47_pins_c: sdmmc2-d47-2 {
		pins {
			pinmux = <STM32_PINMUX('A', 8, AF9)>,  
				 <STM32_PINMUX('A', 15, AF9)>,  
				 <STM32_PINMUX('C', 6, AF10)>,  
				 <STM32_PINMUX('C', 7, AF10)>;  
			slew-rate = <1>;
			drive-push-pull;
			bias-pull-up;
		};
	};
	sdmmc2_d47_sleep_pins_c: sdmmc2-d47-sleep-2 {
		pins {
			pinmux = <STM32_PINMUX('A', 8, ANALOG)>,  
				 <STM32_PINMUX('A', 15, ANALOG)>,  
				 <STM32_PINMUX('C', 6, ANALOG)>,  
				 <STM32_PINMUX('C', 7, ANALOG)>;  
		};
	};
	sdmmc2_d47_pins_d: sdmmc2-d47-3 {
		pins {
			pinmux = <STM32_PINMUX('A', 8, AF9)>,  
				 <STM32_PINMUX('A', 9, AF10)>,  
				 <STM32_PINMUX('E', 5, AF9)>,  
				 <STM32_PINMUX('C', 7, AF10)>;  
		};
	};
	sdmmc2_d47_sleep_pins_d: sdmmc2-d47-sleep-3 {
		pins {
			pinmux = <STM32_PINMUX('A', 8, ANALOG)>,  
				 <STM32_PINMUX('A', 9, ANALOG)>,  
				 <STM32_PINMUX('E', 5, ANALOG)>,  
				 <STM32_PINMUX('C', 7, ANALOG)>;  
		};
	};
	sdmmc2_d47_pins_e: sdmmc2-d47-4 {
		pins {
			pinmux = <STM32_PINMUX('A', 8, AF9)>,	 
				 <STM32_PINMUX('A', 9, AF10)>,	 
				 <STM32_PINMUX('C', 6, AF10)>,	 
				 <STM32_PINMUX('D', 3, AF9)>;	 
			slew-rate = <1>;
			drive-push-pull;
			bias-pull-up;
		};
	};
	sdmmc2_d47_sleep_pins_e: sdmmc2-d47-sleep-4 {
		pins {
			pinmux = <STM32_PINMUX('A', 8, ANALOG)>,  
				 <STM32_PINMUX('A', 9, ANALOG)>,  
				 <STM32_PINMUX('C', 6, ANALOG)>,  
				 <STM32_PINMUX('D', 3, ANALOG)>;  
		};
	};
	sdmmc3_b4_pins_a: sdmmc3-b4-0 {
		pins1 {
			pinmux = <STM32_PINMUX('F', 0, AF9)>,  
				 <STM32_PINMUX('F', 4, AF9)>,  
				 <STM32_PINMUX('F', 5, AF9)>,  
				 <STM32_PINMUX('D', 7, AF10)>,  
				 <STM32_PINMUX('F', 1, AF9)>;  
			slew-rate = <1>;
			drive-push-pull;
			bias-pull-up;
		};
		pins2 {
			pinmux = <STM32_PINMUX('G', 15, AF10)>;  
			slew-rate = <2>;
			drive-push-pull;
			bias-pull-up;
		};
	};
	sdmmc3_b4_od_pins_a: sdmmc3-b4-od-0 {
		pins1 {
			pinmux = <STM32_PINMUX('F', 0, AF9)>,  
				 <STM32_PINMUX('F', 4, AF9)>,  
				 <STM32_PINMUX('F', 5, AF9)>,  
				 <STM32_PINMUX('D', 7, AF10)>;  
			slew-rate = <1>;
			drive-push-pull;
			bias-pull-up;
		};
		pins2 {
			pinmux = <STM32_PINMUX('G', 15, AF10)>;  
			slew-rate = <2>;
			drive-push-pull;
			bias-pull-up;
		};
		pins3 {
			pinmux = <STM32_PINMUX('F', 1, AF9)>;  
			slew-rate = <1>;
			drive-open-drain;
			bias-pull-up;
		};
	};
	sdmmc3_b4_sleep_pins_a: sdmmc3-b4-sleep-0 {
		pins {
			pinmux = <STM32_PINMUX('F', 0, ANALOG)>,  
				 <STM32_PINMUX('F', 4, ANALOG)>,  
				 <STM32_PINMUX('F', 5, ANALOG)>,  
				 <STM32_PINMUX('D', 7, ANALOG)>,  
				 <STM32_PINMUX('G', 15, ANALOG)>,  
				 <STM32_PINMUX('F', 1, ANALOG)>;  
		};
	};
	sdmmc3_b4_pins_b: sdmmc3-b4-1 {
		pins1 {
			pinmux = <STM32_PINMUX('F', 0, AF9)>,  
				 <STM32_PINMUX('F', 4, AF9)>,  
				 <STM32_PINMUX('D', 5, AF10)>,  
				 <STM32_PINMUX('D', 7, AF10)>,  
				 <STM32_PINMUX('D', 0, AF10)>;  
			slew-rate = <1>;
			drive-push-pull;
			bias-pull-up;
		};
		pins2 {
			pinmux = <STM32_PINMUX('G', 15, AF10)>;  
			slew-rate = <2>;
			drive-push-pull;
			bias-pull-up;
		};
	};
	sdmmc3_b4_od_pins_b: sdmmc3-b4-od-1 {
		pins1 {
			pinmux = <STM32_PINMUX('F', 0, AF9)>,  
				 <STM32_PINMUX('F', 4, AF9)>,  
				 <STM32_PINMUX('D', 5, AF10)>,  
				 <STM32_PINMUX('D', 7, AF10)>;  
			slew-rate = <1>;
			drive-push-pull;
			bias-pull-up;
		};
		pins2 {
			pinmux = <STM32_PINMUX('G', 15, AF10)>;  
			slew-rate = <2>;
			drive-push-pull;
			bias-pull-up;
		};
		pins3 {
			pinmux = <STM32_PINMUX('D', 0, AF10)>;  
			slew-rate = <1>;
			drive-open-drain;
			bias-pull-up;
		};
	};
	sdmmc3_b4_sleep_pins_b: sdmmc3-b4-sleep-1 {
		pins {
			pinmux = <STM32_PINMUX('F', 0, ANALOG)>,  
				 <STM32_PINMUX('F', 4, ANALOG)>,  
				 <STM32_PINMUX('D', 5, ANALOG)>,  
				 <STM32_PINMUX('D', 7, ANALOG)>,  
				 <STM32_PINMUX('G', 15, ANALOG)>,  
				 <STM32_PINMUX('D', 0, ANALOG)>;  
		};
	};
	spdifrx_pins_a: spdifrx-0 {
		pins {
			pinmux = <STM32_PINMUX('G', 12, AF8)>;  
			bias-disable;
		};
	};
	spdifrx_sleep_pins_a: spdifrx-sleep-0 {
		pins {
			pinmux = <STM32_PINMUX('G', 12, ANALOG)>;  
		};
	};
	spi1_pins_b: spi1-1 {
		pins1 {
			pinmux = <STM32_PINMUX('A', 5, AF5)>,  
				 <STM32_PINMUX('B', 5, AF5)>;  
			bias-disable;
			drive-push-pull;
			slew-rate = <1>;
		};
		pins2 {
			pinmux = <STM32_PINMUX('A', 6, AF5)>;  
			bias-disable;
		};
	};
	spi2_pins_a: spi2-0 {
		pins1 {
			pinmux = <STM32_PINMUX('B', 10, AF5)>,  
				 <STM32_PINMUX('I', 3, AF5)>;  
			bias-disable;
			drive-push-pull;
			slew-rate = <1>;
		};
		pins2 {
			pinmux = <STM32_PINMUX('I', 2, AF5)>;  
			bias-disable;
		};
	};
	spi2_pins_b: spi2-1 {
		pins1 {
			pinmux = <STM32_PINMUX('I', 1, AF5)>,  
				 <STM32_PINMUX('I', 3, AF5)>;  
			bias-disable;
			drive-push-pull;
			slew-rate = <1>;
		};
		pins2 {
			pinmux = <STM32_PINMUX('I', 2, AF5)>;  
			bias-disable;
		};
	};
	spi2_pins_c: spi2-2 {
		pins1 {
			pinmux = <STM32_PINMUX('I', 1, AF5)>,  
				 <STM32_PINMUX('I', 3, AF5)>;  
			bias-disable;
			drive-push-pull;
		};
		pins2 {
			pinmux = <STM32_PINMUX('I', 2, AF5)>;  
			bias-pull-down;
		};
	};
	spi4_pins_a: spi4-0 {
		pins {
			pinmux = <STM32_PINMUX('E', 12, AF5)>,  
				 <STM32_PINMUX('E', 6, AF5)>;   
			bias-disable;
			drive-push-pull;
			slew-rate = <1>;
		};
		pins2 {
			pinmux = <STM32_PINMUX('E', 13, AF5)>;  
			bias-disable;
		};
	};
	spi5_pins_a: spi5-0 {
		pins1 {
			pinmux = <STM32_PINMUX('F', 7, AF5)>,  
				 <STM32_PINMUX('F', 9, AF5)>;  
			bias-disable;
			drive-push-pull;
			slew-rate = <1>;
		};
		pins2 {
			pinmux = <STM32_PINMUX('F', 8, AF5)>;  
			bias-disable;
		};
	};
	stusb1600_pins_a: stusb1600-0 {
		pins {
			pinmux = <STM32_PINMUX('I', 11, GPIO)>;
			bias-pull-up;
		};
	};
	uart4_pins_a: uart4-0 {
		pins1 {
			pinmux = <STM32_PINMUX('G', 11, AF6)>;  
			bias-disable;
			drive-push-pull;
			slew-rate = <0>;
		};
		pins2 {
			pinmux = <STM32_PINMUX('B', 2, AF8)>;  
			bias-disable;
		};
	};
	uart4_idle_pins_a: uart4-idle-0 {
		pins1 {
			pinmux = <STM32_PINMUX('G', 11, ANALOG)>;  
		};
		pins2 {
			pinmux = <STM32_PINMUX('B', 2, AF8)>;  
			bias-disable;
		};
	};
	uart4_sleep_pins_a: uart4-sleep-0 {
		pins {
			pinmux = <STM32_PINMUX('G', 11, ANALOG)>,  
				 <STM32_PINMUX('B', 2, ANALOG)>;  
		};
	};
	uart4_pins_b: uart4-1 {
		pins1 {
			pinmux = <STM32_PINMUX('D', 1, AF8)>;  
			bias-disable;
			drive-push-pull;
			slew-rate = <0>;
		};
		pins2 {
			pinmux = <STM32_PINMUX('B', 2, AF8)>;  
			bias-disable;
		};
	};
	uart4_pins_c: uart4-2 {
		pins1 {
			pinmux = <STM32_PINMUX('G', 11, AF6)>;  
			bias-disable;
			drive-push-pull;
			slew-rate = <0>;
		};
		pins2 {
			pinmux = <STM32_PINMUX('B', 2, AF8)>;  
			bias-disable;
		};
	};
	uart4_pins_d: uart4-3 {
		pins1 {
			pinmux = <STM32_PINMUX('A', 13, AF8)>;  
			bias-disable;
			drive-push-pull;
			slew-rate = <0>;
		};
		pins2 {
			pinmux = <STM32_PINMUX('B', 2, AF8)>;  
			bias-disable;
		};
	};
	uart4_idle_pins_d: uart4-idle-3 {
		pins1 {
			pinmux = <STM32_PINMUX('A', 13, ANALOG)>;  
		};
		pins2 {
			pinmux = <STM32_PINMUX('B', 2, AF8)>;  
			bias-disable;
		};
	};
	uart4_sleep_pins_d: uart4-sleep-3 {
		pins {
			pinmux = <STM32_PINMUX('A', 13, ANALOG)>,  
				 <STM32_PINMUX('B', 2, ANALOG)>;  
		};
	};
	uart5_pins_a: uart5-0 {
		pins1 {
			pinmux = <STM32_PINMUX('B', 13, AF14)>;  
			bias-disable;
			drive-push-pull;
			slew-rate = <0>;
		};
		pins2 {
			pinmux = <STM32_PINMUX('B', 5, AF12)>;  
			bias-disable;
		};
	};
	uart7_pins_a: uart7-0 {
		pins1 {
			pinmux = <STM32_PINMUX('E', 8, AF7)>;  
			bias-disable;
			drive-push-pull;
			slew-rate = <0>;
		};
		pins2 {
			pinmux = <STM32_PINMUX('E', 7, AF7)>,  
				 <STM32_PINMUX('E', 10, AF7)>,  
				 <STM32_PINMUX('E', 9, AF7)>;  
			bias-disable;
		};
	};
	uart7_pins_b: uart7-1 {
		pins1 {
			pinmux = <STM32_PINMUX('F', 7, AF7)>;  
			bias-disable;
			drive-push-pull;
			slew-rate = <0>;
		};
		pins2 {
			pinmux = <STM32_PINMUX('F', 6, AF7)>;  
			bias-disable;
		};
	};
	uart7_pins_c: uart7-2 {
		pins1 {
			pinmux = <STM32_PINMUX('E', 8, AF7)>;  
			bias-disable;
			drive-push-pull;
			slew-rate = <0>;
		};
		pins2 {
			pinmux = <STM32_PINMUX('E', 7, AF7)>;  
			bias-pull-up;
		};
	};
	uart7_idle_pins_c: uart7-idle-2 {
		pins1 {
			pinmux = <STM32_PINMUX('E', 8, ANALOG)>;  
		};
		pins2 {
			pinmux = <STM32_PINMUX('E', 7, AF7)>;  
			bias-pull-up;
		};
	};
	uart7_sleep_pins_c: uart7-sleep-2 {
		pins {
			pinmux = <STM32_PINMUX('E', 8, ANALOG)>,  
				 <STM32_PINMUX('E', 7, ANALOG)>;  
		};
	};
	uart8_pins_a: uart8-0 {
		pins1 {
			pinmux = <STM32_PINMUX('E', 1, AF8)>;  
			bias-disable;
			drive-push-pull;
			slew-rate = <0>;
		};
		pins2 {
			pinmux = <STM32_PINMUX('E', 0, AF8)>;  
			bias-disable;
		};
	};
	uart8_rtscts_pins_a: uart8rtscts-0 {
		pins {
			pinmux = <STM32_PINMUX('G', 7, AF8)>,  
				 <STM32_PINMUX('G', 10, AF8)>;  
			bias-disable;
		};
	};
	usart1_pins_a: usart1-0 {
		pins1 {
			pinmux = <STM32_PINMUX('A', 12, AF7)>;  
			bias-disable;
			drive-push-pull;
			slew-rate = <0>;
		};
		pins2 {
			pinmux = <STM32_PINMUX('A', 11, AF7)>;  
			bias-disable;
		};
	};
	usart1_idle_pins_a: usart1-idle-0 {
		pins1 {
			pinmux = <STM32_PINMUX('A', 12, ANALOG)>,  
				 <STM32_PINMUX('A', 11, AF7)>;  
		};
	};
	usart1_sleep_pins_a: usart1-sleep-0 {
		pins {
			pinmux = <STM32_PINMUX('A', 12, ANALOG)>,  
				 <STM32_PINMUX('A', 11, ANALOG)>;  
		};
	};
	usart2_pins_a: usart2-0 {
		pins1 {
			pinmux = <STM32_PINMUX('F', 5, AF7)>,  
				 <STM32_PINMUX('D', 4, AF7)>;  
			bias-disable;
			drive-push-pull;
			slew-rate = <0>;
		};
		pins2 {
			pinmux = <STM32_PINMUX('D', 6, AF7)>,  
				 <STM32_PINMUX('D', 3, AF7)>;  
			bias-disable;
		};
	};
	usart2_sleep_pins_a: usart2-sleep-0 {
		pins {
			pinmux = <STM32_PINMUX('F', 5, ANALOG)>,  
				 <STM32_PINMUX('D', 4, ANALOG)>,  
				 <STM32_PINMUX('D', 6, ANALOG)>,  
				 <STM32_PINMUX('D', 3, ANALOG)>;  
		};
	};
	usart2_pins_b: usart2-1 {
		pins1 {
			pinmux = <STM32_PINMUX('F', 5, AF7)>,  
				 <STM32_PINMUX('A', 1, AF7)>;  
			bias-disable;
			drive-push-pull;
			slew-rate = <0>;
		};
		pins2 {
			pinmux = <STM32_PINMUX('F', 4, AF7)>,  
				 <STM32_PINMUX('E', 15, AF7)>;  
			bias-disable;
		};
	};
	usart2_sleep_pins_b: usart2-sleep-1 {
		pins {
			pinmux = <STM32_PINMUX('F', 5, ANALOG)>,  
				 <STM32_PINMUX('A', 1, ANALOG)>,  
				 <STM32_PINMUX('F', 4, ANALOG)>,  
				 <STM32_PINMUX('E', 15, ANALOG)>;  
		};
	};
	usart2_pins_c: usart2-2 {
		pins1 {
			pinmux = <STM32_PINMUX('D', 5, AF7)>,  
				 <STM32_PINMUX('D', 4, AF7)>;  
			bias-disable;
			drive-push-pull;
			slew-rate = <0>;
		};
		pins2 {
			pinmux = <STM32_PINMUX('D', 6, AF7)>,  
				 <STM32_PINMUX('D', 3, AF7)>;  
			bias-disable;
		};
	};
	usart2_idle_pins_c: usart2-idle-2 {
		pins1 {
			pinmux = <STM32_PINMUX('D', 5, ANALOG)>,  
				 <STM32_PINMUX('D', 3, ANALOG)>;  
		};
		pins2 {
			pinmux = <STM32_PINMUX('D', 4, AF7)>;  
			bias-disable;
			drive-push-pull;
			slew-rate = <0>;
		};
		pins3 {
			pinmux = <STM32_PINMUX('D', 6, AF7)>;  
			bias-disable;
		};
	};
	usart2_sleep_pins_c: usart2-sleep-2 {
		pins {
			pinmux = <STM32_PINMUX('D', 5, ANALOG)>,  
				 <STM32_PINMUX('D', 4, ANALOG)>,  
				 <STM32_PINMUX('D', 6, ANALOG)>,  
				 <STM32_PINMUX('D', 3, ANALOG)>;  
		};
	};
	usart3_pins_a: usart3-0 {
		pins1 {
			pinmux = <STM32_PINMUX('B', 10, AF7)>;  
			bias-disable;
			drive-push-pull;
			slew-rate = <0>;
		};
		pins2 {
			pinmux = <STM32_PINMUX('B', 12, AF8)>;  
			bias-disable;
		};
	};
	usart3_idle_pins_a: usart3-idle-0 {
		pins1 {
			pinmux = <STM32_PINMUX('B', 10, ANALOG)>;  
		};
		pins2 {
			pinmux = <STM32_PINMUX('B', 12, AF8)>;  
			bias-disable;
		};
	};
	usart3_sleep_pins_a: usart3-sleep-0 {
		pins {
			pinmux = <STM32_PINMUX('B', 10, ANALOG)>,  
				 <STM32_PINMUX('B', 12, ANALOG)>;  
		};
	};
	usart3_pins_b: usart3-1 {
		pins1 {
			pinmux = <STM32_PINMUX('B', 10, AF7)>,  
				 <STM32_PINMUX('G', 8, AF8)>;  
			bias-disable;
			drive-push-pull;
			slew-rate = <0>;
		};
		pins2 {
			pinmux = <STM32_PINMUX('B', 12, AF8)>,  
				 <STM32_PINMUX('I', 10, AF8)>;  
			bias-pull-up;
		};
	};
	usart3_idle_pins_b: usart3-idle-1 {
		pins1 {
			pinmux = <STM32_PINMUX('B', 10, ANALOG)>,  
				 <STM32_PINMUX('I', 10, ANALOG)>;  
		};
		pins2 {
			pinmux = <STM32_PINMUX('G', 8, AF8)>;  
			bias-disable;
			drive-push-pull;
			slew-rate = <0>;
		};
		pins3 {
			pinmux = <STM32_PINMUX('B', 12, AF8)>;  
			bias-pull-up;
		};
	};
	usart3_sleep_pins_b: usart3-sleep-1 {
		pins {
			pinmux = <STM32_PINMUX('B', 10, ANALOG)>,  
				 <STM32_PINMUX('G', 8, ANALOG)>,  
				 <STM32_PINMUX('I', 10, ANALOG)>,  
				 <STM32_PINMUX('B', 12, ANALOG)>;  
		};
	};
	usart3_pins_c: usart3-2 {
		pins1 {
			pinmux = <STM32_PINMUX('B', 10, AF7)>,  
				 <STM32_PINMUX('G', 8, AF8)>;  
			bias-disable;
			drive-push-pull;
			slew-rate = <0>;
		};
		pins2 {
			pinmux = <STM32_PINMUX('B', 12, AF8)>,  
				 <STM32_PINMUX('B', 13, AF7)>;  
			bias-pull-up;
		};
	};
	usart3_idle_pins_c: usart3-idle-2 {
		pins1 {
			pinmux = <STM32_PINMUX('B', 10, ANALOG)>,  
				 <STM32_PINMUX('B', 13, ANALOG)>;  
		};
		pins2 {
			pinmux = <STM32_PINMUX('G', 8, AF8)>;  
			bias-disable;
			drive-push-pull;
			slew-rate = <0>;
		};
		pins3 {
			pinmux = <STM32_PINMUX('B', 12, AF8)>;  
			bias-pull-up;
		};
	};
	usart3_sleep_pins_c: usart3-sleep-2 {
		pins {
			pinmux = <STM32_PINMUX('B', 10, ANALOG)>,  
				 <STM32_PINMUX('G', 8, ANALOG)>,  
				 <STM32_PINMUX('B', 13, ANALOG)>,  
				 <STM32_PINMUX('B', 12, ANALOG)>;  
		};
	};
	usart3_pins_d: usart3-3 {
		pins1 {
			pinmux = <STM32_PINMUX('B', 10, AF7)>,  
				 <STM32_PINMUX('G', 8, AF8)>;  
			bias-disable;
			drive-push-pull;
			slew-rate = <0>;
		};
		pins2 {
			pinmux = <STM32_PINMUX('D', 9, AF7)>,  
				 <STM32_PINMUX('D', 11, AF7)>;  
			bias-disable;
		};
	};
	usart3_idle_pins_d: usart3-idle-3 {
		pins1 {
			pinmux = <STM32_PINMUX('B', 10, ANALOG)>,  
				 <STM32_PINMUX('G', 8, ANALOG)>,  
				 <STM32_PINMUX('D', 11, ANALOG)>;  
		};
		pins2 {
			pinmux = <STM32_PINMUX('D', 9, AF7)>;  
			bias-disable;
		};
	};
	usart3_sleep_pins_d: usart3-sleep-3 {
		pins {
			pinmux = <STM32_PINMUX('B', 10, ANALOG)>,  
				 <STM32_PINMUX('G', 8, ANALOG)>,  
				 <STM32_PINMUX('D', 11, ANALOG)>,  
				 <STM32_PINMUX('D', 9, ANALOG)>;  
		};
	};
	usart3_pins_e: usart3-4 {
		pins1 {
			pinmux = <STM32_PINMUX('B', 10, AF7)>,  
				 <STM32_PINMUX('G', 8, AF8)>;  
			bias-disable;
			drive-push-pull;
			slew-rate = <0>;
		};
		pins2 {
			pinmux = <STM32_PINMUX('B', 11, AF7)>,  
				 <STM32_PINMUX('D', 11, AF7)>;  
			bias-pull-up;
		};
	};
	usart3_idle_pins_e: usart3-idle-4 {
		pins1 {
			pinmux = <STM32_PINMUX('B', 10, ANALOG)>,  
				 <STM32_PINMUX('D', 11, ANALOG)>;  
		};
		pins2 {
			pinmux = <STM32_PINMUX('G', 8, AF8)>;  
			bias-disable;
			drive-push-pull;
			slew-rate = <0>;
		};
		pins3 {
			pinmux = <STM32_PINMUX('B', 11, AF7)>;  
			bias-pull-up;
		};
	};
	usart3_sleep_pins_e: usart3-sleep-4 {
		pins {
			pinmux = <STM32_PINMUX('B', 10, ANALOG)>,  
				 <STM32_PINMUX('G', 8, ANALOG)>,  
				 <STM32_PINMUX('D', 11, ANALOG)>,  
				 <STM32_PINMUX('B', 11, ANALOG)>;  
		};
	};
	usart3_pins_f: usart3-5 {
		pins1 {
			pinmux = <STM32_PINMUX('B', 10, AF7)>,  
				 <STM32_PINMUX('D', 12, AF7)>;  
			bias-disable;
			drive-push-pull;
			slew-rate = <0>;
		};
		pins2 {
			pinmux = <STM32_PINMUX('B', 12, AF8)>,  
				 <STM32_PINMUX('D', 11, AF7)>;  
			bias-disable;
		};
	};
	usbotg_hs_pins_a: usbotg-hs-0 {
		pins {
			pinmux = <STM32_PINMUX('A', 10, ANALOG)>;  
		};
	};
	usbotg_fs_dp_dm_pins_a: usbotg-fs-dp-dm-0 {
		pins {
			pinmux = <STM32_PINMUX('A', 11, ANALOG)>,  
				 <STM32_PINMUX('A', 12, ANALOG)>;  
		};
	};
};
&pinctrl_z {
	i2c2_pins_b2: i2c2-0 {
		pins {
			pinmux = <STM32_PINMUX('Z', 0, AF3)>;  
			bias-disable;
			drive-open-drain;
			slew-rate = <0>;
		};
	};
	i2c2_sleep_pins_b2: i2c2-sleep-0 {
		pins {
			pinmux = <STM32_PINMUX('Z', 0, ANALOG)>;  
		};
	};
	i2c4_pins_a: i2c4-0 {
		pins {
			pinmux = <STM32_PINMUX('Z', 4, AF6)>,  
				 <STM32_PINMUX('Z', 5, AF6)>;  
			bias-disable;
			drive-open-drain;
			slew-rate = <0>;
		};
	};
	i2c4_sleep_pins_a: i2c4-sleep-0 {
		pins {
			pinmux = <STM32_PINMUX('Z', 4, ANALOG)>,  
				 <STM32_PINMUX('Z', 5, ANALOG)>;  
		};
	};
	i2c6_pins_a: i2c6-0 {
		pins {
			pinmux = <STM32_PINMUX('Z', 6, AF2)>,  
				 <STM32_PINMUX('Z', 7, AF2)>;  
			bias-disable;
			drive-open-drain;
			slew-rate = <0>;
		};
	};
	i2c6_sleep_pins_a: i2c6-sleep-0 {
		pins {
			pinmux = <STM32_PINMUX('Z', 6, ANALOG)>,  
				 <STM32_PINMUX('Z', 7, ANALOG)>;  
		};
	};
	spi1_pins_a: spi1-0 {
		pins1 {
			pinmux = <STM32_PINMUX('Z', 0, AF5)>,  
				 <STM32_PINMUX('Z', 2, AF5)>;  
			bias-disable;
			drive-push-pull;
			slew-rate = <1>;
		};
		pins2 {
			pinmux = <STM32_PINMUX('Z', 1, AF5)>;  
			bias-disable;
		};
	};
	spi1_sleep_pins_a: spi1-sleep-0 {
		pins {
			pinmux = <STM32_PINMUX('Z', 0, ANALOG)>,  
				 <STM32_PINMUX('Z', 1, ANALOG)>,  
				 <STM32_PINMUX('Z', 2, ANALOG)>;  
		};
	};
	usart1_pins_b: usart1-1 {
		pins1 {
			pinmux = <STM32_PINMUX('Z', 7, AF7)>;  
			bias-disable;
			drive-push-pull;
			slew-rate = <0>;
		};
		pins2 {
			pinmux = <STM32_PINMUX('Z', 6, AF7)>;  
			bias-disable;
		};
	};
	usart1_idle_pins_b: usart1-idle-1 {
		pins1 {
			pinmux = <STM32_PINMUX('Z', 7, ANALOG)>;  
		};
		pins2 {
			pinmux = <STM32_PINMUX('Z', 6, AF7)>;  
			bias-disable;
		};
	};
	usart1_sleep_pins_b: usart1-sleep-1 {
		pins {
			pinmux = <STM32_PINMUX('Z', 7, ANALOG)>,  
				 <STM32_PINMUX('Z', 6, ANALOG)>;  
		};
	};
};
