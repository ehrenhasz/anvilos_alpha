#include "armada-39x.dtsi"
/ {
	compatible = "marvell,armada390";
	soc {
		internal-regs {
			pinctrl@18000 {
				compatible = "marvell,mv88f6920-pinctrl";
				reg = <0x18000 0x20>;
			};
		};
	};
};
