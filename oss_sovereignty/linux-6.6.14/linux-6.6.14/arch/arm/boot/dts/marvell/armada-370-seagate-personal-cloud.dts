/dts-v1/;
#include "armada-370-seagate-personal-cloud.dtsi"
/ {
	model = "Seagate Personal Cloud (Cumulus, SRN21C)";
	compatible = "seagate,cumulus", "marvell,armada370", "marvell,armada-370-xp";
	soc {
		internal-regs {
			sata@a0000 {
				status = "okay";
				nr-ports = <1>;
			};
		};
	};
};
