/dts-v1/;
#include "kirkwood-linkstation-duo-6281.dtsi"
/ {
	model = "Buffalo Linkstation LS-WSXL";
	compatible = "buffalo,lswsxl", "marvell,kirkwood-88f6281", "marvell,kirkwood";
	memory {  
		device_type = "memory";
		reg = <0x00000000 0x8000000>;
	};
};
