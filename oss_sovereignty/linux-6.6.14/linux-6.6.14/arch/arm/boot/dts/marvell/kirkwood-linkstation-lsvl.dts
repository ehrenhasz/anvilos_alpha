/dts-v1/;
#include "kirkwood-linkstation-6282.dtsi"
/ {
	model = "Buffalo Linkstation LS-VL";
	compatible = "buffalo,lsvl", "marvell,kirkwood-88f6282", "marvell,kirkwood";
	memory {  
		device_type = "memory";
		reg = <0x00000000 0x10000000>;
	};
};
