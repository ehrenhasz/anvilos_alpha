/dts-v1/;
#include "kirkwood.dtsi"
#include "kirkwood-6282.dtsi"
#include "kirkwood-ts219.dtsi"
#include "kirkwood-ts419.dtsi"
&ethphy0 { reg = <0>; };
&ethphy1 { reg = <1>; };
&pciec { status = "okay"; };
&pcie1 { status = "okay"; };
