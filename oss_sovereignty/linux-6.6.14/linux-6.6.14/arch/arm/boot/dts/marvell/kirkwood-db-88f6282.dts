/dts-v1/;
#include "kirkwood-db.dtsi"
#include "kirkwood-6282.dtsi"
/ {
	model = "Marvell DB-88F6282-BP Development Board";
	compatible = "marvell,db-88f6282-bp", "marvell,kirkwood-88f6282", "marvell,kirkwood";
};
&pciec {
	status = "okay";
};
&pcie0 {
	status = "okay";
};
&pcie1 {
	status = "okay";
};
