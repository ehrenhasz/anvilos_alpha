/dts-v1/;
#include "armada-370-seagate-nas-xbay.dtsi"
/ {
	model = "Seagate NAS 2-Bay (Dart, SRPD20)";
	compatible = "seagate,dart-2", "marvell,armada370", "marvell,armada-370-xp";
	gpio-fan {
		gpio-fan,speed-map =
			<   0 3
			  950 2
			 1400 1
			 1800 0>;
	};
};
