#include "owl-s500.dtsi"
/ {
	model = "Caninos Labrador Core V2.1";
	compatible = "caninos,labrador-v2", "actions,s500";
	memory@0 {
		device_type = "memory";
		reg = <0x0 0x80000000>;
	};
};
&timer {
	clocks = <&hosc>;
};
