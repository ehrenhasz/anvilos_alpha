/dts-v1/;
#include "at91-kizbox2-common.dtsi"
/ {
	model = "Overkiz Kizbox 2 with two heads";
	compatible = "overkiz,kizbox2-2", "atmel,sama5d31",
		     "atmel,sama5d3", "atmel,sama5";
};
&usart1 {
	status = "okay";
};
&usart2 {
	status = "okay";
};
