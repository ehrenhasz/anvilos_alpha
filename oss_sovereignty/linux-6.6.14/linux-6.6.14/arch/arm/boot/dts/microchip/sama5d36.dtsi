#include "sama5d3.dtsi"
#include "sama5d3_can.dtsi"
#include "sama5d3_gmac.dtsi"
#include "sama5d3_emac.dtsi"
#include "sama5d3_lcd.dtsi"
#include "sama5d3_mci2.dtsi"
#include "sama5d3_tcb1.dtsi"
#include "sama5d3_uart.dtsi"
/ {
	compatible = "atmel,sama5d36", "atmel,sama5d3", "atmel,sama5";
};
