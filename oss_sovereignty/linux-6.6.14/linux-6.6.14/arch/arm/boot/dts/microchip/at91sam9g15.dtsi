#include "at91sam9x5.dtsi"
#include "at91sam9x5_lcd.dtsi"
/ {
	model = "Atmel AT91SAM9G15 SoC";
	compatible = "atmel,at91sam9g15", "atmel,at91sam9x5";
};
&pinctrl {
	atmel,mux-mask = <
	       0xffffffff 0xffe0399f 0x00000000   
	       0x00040000 0x00047e3f 0x00000000   
	       0xfdffffff 0x00000000 0xb83fffff   
	       0x003fffff 0x003f8000 0x00000000   
	      >;
};
&pmc {
	compatible = "atmel,at91sam9g15-pmc", "atmel,at91sam9x5-pmc", "syscon";
};
