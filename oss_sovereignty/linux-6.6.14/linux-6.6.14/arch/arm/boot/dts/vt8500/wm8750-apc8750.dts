/dts-v1/;
/include/ "wm8750.dtsi"
/ {
	model = "VIA APC8750";
};
&pinctrl {
	pinctrl-names = "default";
	pinctrl-0 = <&i2c>;
	i2c: i2c {
		wm,pins = <168 169 170 171>;
		wm,function = <2>;	 
		wm,pull = <2>;	 
	};
};
&uart0 {
	status = "okay";
};
