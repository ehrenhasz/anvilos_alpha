#include "exynos4412-odroidx.dts"
#include "exynos4412-prime.dtsi"
/ {
	model = "Hardkernel ODROID-X2 board based on Exynos4412";
	compatible = "hardkernel,odroid-x2", "samsung,exynos4412", "samsung,exynos4";
	memory@40000000 {
		device_type = "memory";
		reg = <0x40000000 0x7ff00000>;
	};
};
