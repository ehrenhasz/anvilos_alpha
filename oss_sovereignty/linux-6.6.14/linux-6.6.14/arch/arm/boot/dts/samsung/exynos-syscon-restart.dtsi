&pmu_system_controller {
	poweroff: syscon-poweroff {
		compatible = "syscon-poweroff";
		regmap = <&pmu_system_controller>;
		offset = <0x330c>;  
		mask = <0x5200>;  
	};
	reboot: syscon-reboot {
		compatible = "syscon-reboot";
		regmap = <&pmu_system_controller>;
		offset = <0x0400>;  
		mask = <0x1>;
	};
};
