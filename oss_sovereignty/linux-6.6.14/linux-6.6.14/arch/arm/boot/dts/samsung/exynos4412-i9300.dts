/dts-v1/;
#include "exynos4412-galaxy-s3.dtsi"
/ {
	model = "Samsung Galaxy S3 (GT-I9300) based on Exynos4412";
	compatible = "samsung,i9300", "samsung,midas", "samsung,exynos4412", "samsung,exynos4";
	chassis-type = "handset";
	memory@40000000 {
		device_type = "memory";
		reg = <0x40000000 0x40000000>;
	};
};
&sound {
	fm-sel-gpios = <&gpl0 3 GPIO_ACTIVE_HIGH>;
};
