/dts-v1/;
#include "exynos4212-tab3.dtsi"
/ {
	model = "Samsung Galaxy Tab 3 8.0 WiFi (SM-T310) based on Exynos4212";
	compatible = "samsung,t310", "samsung,tab3", "samsung,exynos4212", "samsung,exynos4";
	chassis-type = "tablet";
};
&i2c_lightsensor {
	status = "okay";
	lightsensor@10 {
		compatible = "capella,cm3323";
		reg = <0x10>;
	};
};
