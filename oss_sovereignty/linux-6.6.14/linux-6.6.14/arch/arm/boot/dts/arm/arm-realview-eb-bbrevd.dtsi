/ {
	veth: fixedregulator@0 {
		compatible = "regulator-fixed";
		regulator-name = "veth";
		regulator-min-microvolt = <3300000>;
		regulator-max-microvolt = <3300000>;
		regulator-boot-on;
	};
};
&ethernet {
	compatible = "smsc,lan9118", "smsc,lan9115";
	phy-mode = "mii";
	smsc,irq-active-high;
	smsc,irq-push-pull;
	vdd33a-supply = <&veth>;
	vddvario-supply = <&veth>;
};
