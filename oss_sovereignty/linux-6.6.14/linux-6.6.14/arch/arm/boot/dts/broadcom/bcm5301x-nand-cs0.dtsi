/ {
	nand-controller@18028000 {
		nandcs: nand@0 {
			compatible = "brcm,nandcs";
			reg = <0>;
			#address-cells = <1>;
			#size-cells = <1>;
			partitions {
				compatible = "brcm,bcm947xx-cfe-partitions";
			};
		};
	};
};
