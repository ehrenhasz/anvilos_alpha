/dts-v1/;
#include "bcm958625-meraki-kingpin.dtsi"
/ {
	model = "Cisco Meraki MX64";
	compatible = "meraki,mx64", "brcm,bcm58625", "brcm,nsp";
	chosen {
		stdout-path = "serial0:115200n8";
	};
	memory@60000000 {
		device_type = "memory";
		reg = <0x60000000 0x80000000>;
	};
};
