/dts-v1/;
#include "bcm-cygnus.dtsi"
/ {
	model = "Cygnus SVK (BCM911360K)";
	compatible = "brcm,bcm11360", "brcm,cygnus";
	aliases {
		serial0 = &uart3;
	};
	chosen {
		stdout-path = "serial0:115200n8";
	};
};
&uart3 {
	status = "okay";
};
