/dts-v1/;
#include "bcm4708.dtsi"
/ {
	model = "NorthStar SVK (BCM94708)";
	compatible = "brcm,bcm94708", "brcm,bcm4708";
	memory@0 {
		device_type = "memory";
		reg = <0x00000000 0x08000000>;
	};
};
&usb3_phy {
	status = "okay";
};
