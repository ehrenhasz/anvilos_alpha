/dts-v1/;
#include "k3-am6548-iot2050-advanced-common.dtsi"
#include "k3-am65-iot2050-common-pg1.dtsi"
/ {
	compatible = "siemens,iot2050-advanced", "ti,am654";
	model = "SIMATIC IOT2050 Advanced";
};
