/dts-v1/;
#include "k3-am625.dtsi"
#include "k3-am62-verdin.dtsi"
#include "k3-am62-verdin-nonwifi.dtsi"
#include "k3-am62-verdin-yavia.dtsi"
/ {
	model = "Toradex Verdin AM62 on Yavia Board";
	compatible = "toradex,verdin-am62-nonwifi-yavia",
		     "toradex,verdin-am62-nonwifi",
		     "toradex,verdin-am62",
		     "ti,am625";
};
