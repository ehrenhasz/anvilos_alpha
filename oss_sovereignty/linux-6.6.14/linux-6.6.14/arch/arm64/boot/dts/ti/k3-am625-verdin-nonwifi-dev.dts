/dts-v1/;
#include "k3-am625.dtsi"
#include "k3-am62-verdin.dtsi"
#include "k3-am62-verdin-nonwifi.dtsi"
#include "k3-am62-verdin-dev.dtsi"
/ {
	model = "Toradex Verdin AM62 on Verdin Development Board";
	compatible = "toradex,verdin-am62-nonwifi-dev",
		     "toradex,verdin-am62-nonwifi",
		     "toradex,verdin-am62",
		     "ti,am625";
};
