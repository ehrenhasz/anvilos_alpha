/dts-v1/;
#include "k3-am6548-iot2050-advanced-common.dtsi"
#include "k3-am65-iot2050-common-pg2.dtsi"
/ {
	compatible = "siemens,iot2050-advanced-pg2", "ti,am654";
	model = "SIMATIC IOT2050 Advanced PG2";
};
&mcu_r5fss0 {
	ti,cluster-mode = <0>;
};
