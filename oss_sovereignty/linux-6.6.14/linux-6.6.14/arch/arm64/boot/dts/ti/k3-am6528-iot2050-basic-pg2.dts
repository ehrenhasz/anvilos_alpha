/dts-v1/;
#include "k3-am6528-iot2050-basic-common.dtsi"
#include "k3-am65-iot2050-common-pg2.dtsi"
/ {
	compatible = "siemens,iot2050-basic-pg2", "ti,am654";
	model = "SIMATIC IOT2050 Basic PG2";
};
