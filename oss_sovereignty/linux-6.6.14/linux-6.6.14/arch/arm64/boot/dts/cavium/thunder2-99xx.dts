/dts-v1/;
#include "thunder2-99xx.dtsi"
/ {
	model = "Cavium ThunderX2 CN99XX";
	compatible = "cavium,thunderx2-cn9900", "brcm,vulcan-soc";
	memory {
		device_type = "memory";
		reg = <0x00000000 0x80000000 0x0 0x80000000>,   
		      <0x00000008 0x80000000 0x0 0x80000000>;   
	};
	aliases {
		serial0 = &uart0;
	};
	chosen {
		stdout-path = "serial0:115200n8";
	};
};
