/dts-v1/;
/include/ "thunder-88xx.dtsi"
/ {
	model = "Cavium ThunderX CN88XX board";
	compatible = "cavium,thunder-88xx";
	aliases {
		serial0 = &uaa0;
		serial1 = &uaa1;
	};
	memory@0 {
		device_type = "memory";
		reg = <0x0 0x00000000 0x0 0x80000000>;
	};
};
