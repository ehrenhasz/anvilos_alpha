/dts-v1/;
#include "sparx5_pcb135_board.dtsi"
#include "sparx5_nand.dtsi"
/ {
	model = "Sparx5 PCB135 Reference Board (NAND)";
	compatible = "microchip,sparx5-pcb135", "microchip,sparx5";
	memory@0 {
		device_type = "memory";
		reg = <0x00000000 0x00000000 0x10000000>;
	};
};
