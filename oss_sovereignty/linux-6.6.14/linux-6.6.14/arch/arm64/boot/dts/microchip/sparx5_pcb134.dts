/dts-v1/;
#include "sparx5_pcb134_board.dtsi"
#include "sparx5_nand.dtsi"
/ {
	model = "Sparx5 PCB134 Reference Board (NAND)";
	compatible = "microchip,sparx5-pcb134", "microchip,sparx5";
	memory@0 {
		device_type = "memory";
		reg = <0x00000000 0x00000000 0x10000000>;
	};
};
