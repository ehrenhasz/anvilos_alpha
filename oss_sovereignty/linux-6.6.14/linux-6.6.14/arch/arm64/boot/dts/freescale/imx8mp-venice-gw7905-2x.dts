/dts-v1/;
#include "imx8mp.dtsi"
#include "imx8mp-venice-gw702x.dtsi"
#include "imx8mp-venice-gw7905.dtsi"
/ {
	model = "Gateworks Venice GW7905-2x i.MX8MP Development Kit";
	compatible = "gateworks,imx8mp-gw7905-2x", "fsl,imx8mp";
	chosen {
		stdout-path = &uart2;
	};
};
&eqos {
	status = "disabled";
};
&usdhc1 {
	status = "disabled";
};
