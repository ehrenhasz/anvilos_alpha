/dts-v1/;
#include "fsl-ls2088a.dtsi"
#include "fsl-ls208xa-qds.dtsi"
/ {
	model = "Freescale Layerscape 2088A QDS Board";
	compatible = "fsl,ls2088a-qds", "fsl,ls2088a";
	chosen {
		stdout-path = "serial0:115200n8";
	};
};
