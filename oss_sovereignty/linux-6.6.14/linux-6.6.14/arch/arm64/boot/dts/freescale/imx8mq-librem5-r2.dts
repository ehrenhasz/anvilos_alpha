/dts-v1/;
#include "imx8mq-librem5.dtsi"
/ {
	model = "Purism Librem 5r2";
	compatible = "purism,librem5r2", "purism,librem5", "fsl,imx8mq";
};
&accel_gyro {
	mount-matrix = "1",  "0",  "0",
		       "0", "-1",  "0",
		       "0",  "0",  "1";
};
&bq25895 {
	ti,charge-current = <1600000>;  
};
&proximity {
	proximity-near-level = <50>;
};
