/dts-v1/;
#include "fsl-ls2080a.dtsi"
#include "fsl-ls208xa-qds.dtsi"
/ {
	model = "Freescale Layerscape 2080a QDS Board";
	compatible = "fsl,ls2080a-qds", "fsl,ls2080a";
	chosen {
		stdout-path = "serial0:115200n8";
	};
};
