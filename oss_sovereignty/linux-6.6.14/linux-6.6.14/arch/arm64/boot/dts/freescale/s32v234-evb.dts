/dts-v1/;
#include "s32v234.dtsi"
/ {
	model = "NXP S32V234-EVB2 Board";
	compatible = "fsl,s32v234-evb", "fsl,s32v234";
	chosen {
		stdout-path = "serial0:115200n8";
	};
};
&uart0 {
	status = "okay";
};
&uart1 {
	status = "okay";
};
