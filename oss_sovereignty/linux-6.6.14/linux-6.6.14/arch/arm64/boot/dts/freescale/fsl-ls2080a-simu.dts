/dts-v1/;
#include "fsl-ls2080a.dtsi"
/ {
	model = "Freescale Layerscape 2080a software Simulator model";
	compatible = "fsl,ls2080a-simu", "fsl,ls2080a";
	ethernet@2210000 {
		compatible = "smsc,lan91c111";
		reg = <0x0 0x2210000 0x0 0x100>;
		interrupts = <0 58 0x1>;
	};
};
&ifc {
	status = "okay";
};
