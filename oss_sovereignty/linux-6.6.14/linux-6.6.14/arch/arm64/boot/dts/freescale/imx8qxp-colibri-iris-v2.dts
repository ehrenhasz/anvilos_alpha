/dts-v1/;
#include "imx8qxp-colibri.dtsi"
#include "imx8x-colibri-iris-v2.dtsi"
/ {
	model = "Toradex Colibri iMX8QXP on Colibri Iris V2 Board";
	compatible = "toradex,colibri-imx8x-iris-v2",
		     "toradex,colibri-imx8x",
		     "fsl,imx8qxp";
};
