/dts-v1/;
#include "sun50i-h6-tanix.dtsi"
/ {
	model = "Tanix TX6";
	compatible = "oranth,tanix-tx6", "allwinner,sun50i-h6";
};
&r_ir {
	linux,rc-map-name = "rc-tanix-tx5max";
};
&uart1 {
	pinctrl-names = "default";
	pinctrl-0 = <&uart1_pins>, <&uart1_rts_cts_pins>;
	uart-has-rtscts;
	status = "okay";
	bluetooth {
		compatible = "realtek,rtl8822cs-bt";
		device-wake-gpios = <&r_pio 1 2 GPIO_ACTIVE_HIGH>;  
		host-wake-gpios = <&r_pio 1 1 GPIO_ACTIVE_HIGH>;  
		enable-gpios = <&r_pio 1 4 GPIO_ACTIVE_HIGH>;  
	};
};
