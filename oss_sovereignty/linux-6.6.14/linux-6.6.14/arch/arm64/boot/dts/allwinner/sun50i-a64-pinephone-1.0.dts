/dts-v1/;
#include "sun50i-a64-pinephone.dtsi"
/ {
	model = "Pine64 PinePhone Developer Batch (1.0)";
	compatible = "pine64,pinephone-1.0", "pine64,pinephone", "allwinner,sun50i-a64";
};
&codec_analog {
	allwinner,internal-bias-resistor;
};
&sgm3140 {
	enable-gpios = <&pio 2 3 GPIO_ACTIVE_HIGH>;  
	flash-gpios = <&pio 3 24 GPIO_ACTIVE_HIGH>;  
};
