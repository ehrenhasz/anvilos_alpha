/dts-v1/;
#include "sun50i-h5.dtsi"
#include "sun50i-h5-cpu-opp.dtsi"
#include <arm/allwinner/sunxi-libretech-all-h3-cc.dtsi>
/ {
	model = "Libre Computer Board ALL-H3-CC H5";
	compatible = "libretech,all-h3-cc-h5", "allwinner,sun50i-h5";
};
&mmc2 {
	mmc-ddr-3_3v;
};
