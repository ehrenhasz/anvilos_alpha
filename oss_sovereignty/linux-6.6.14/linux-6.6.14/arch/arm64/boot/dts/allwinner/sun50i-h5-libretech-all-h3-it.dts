/dts-v1/;
#include "sun50i-h5.dtsi"
#include <arm/allwinner/sunxi-libretech-all-h3-it.dtsi>
/ {
	model = "Libre Computer Board ALL-H3-IT H5";
	compatible = "libretech,all-h3-it-h5", "allwinner,sun50i-h5";
};
