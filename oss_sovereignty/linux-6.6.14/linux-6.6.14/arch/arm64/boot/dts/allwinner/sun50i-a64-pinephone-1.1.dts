/dts-v1/;
#include "sun50i-a64-pinephone.dtsi"
/ {
	model = "Pine64 PinePhone Braveheart (1.1)";
	compatible = "pine64,pinephone-1.1", "pine64,pinephone", "allwinner,sun50i-a64";
};
&backlight {
	power-supply = <&reg_ldo_io0>;
	brightness-levels = <
		774  793  814  842
		882  935  1003 1088
		1192 1316 1462 1633
		1830 2054 2309 2596
		2916 3271 3664 4096>;
	num-interpolated-steps = <50>;
	default-brightness-level = <400>;
};
&codec_analog {
	allwinner,internal-bias-resistor;
};
&sgm3140 {
	enable-gpios = <&pio 3 24 GPIO_ACTIVE_HIGH>;  
	flash-gpios = <&pio 2 3 GPIO_ACTIVE_HIGH>;  
};
