pcie8: pcie@60400000 {
	compatible = "brcm,iproc-pcie-paxc-v2";
	reg = <0 0x60400000 0 0x1000>;
	linux,pci-domain = <8>;
	bus-range = <0x0 0x1>;
	#address-cells = <3>;
	#size-cells = <2>;
	device_type = "pci";
	ranges = <0x83000000 0 0x10000000 0 0x10000000 0 0x20000000>;
	dma-coherent;
	msi-map = <0x100 &gic_its 0x2000 0x1>,  
		  <0x108 &gic_its 0x2040 0x8>,  
		  <0x101 &gic_its 0x2080 0x1>,  
		  <0x110 &gic_its 0x20c8 0x8>,  
		  <0x102 &gic_its 0x2100 0x1>,  
		  <0x118 &gic_its 0x2150 0x8>,  
		  <0x103 &gic_its 0x2180 0x1>,  
		  <0x120 &gic_its 0x21d8 0x8>,  
		  <0x104 &gic_its 0x2200 0x1>,  
		  <0x128 &gic_its 0x2260 0x8>,  
		  <0x105 &gic_its 0x2280 0x1>,  
		  <0x130 &gic_its 0x22e8 0x8>,  
		  <0x106 &gic_its 0x2300 0x1>,  
		  <0x138 &gic_its 0x2370 0x8>,  
		  <0x107 &gic_its 0x2380 0x1>,  
		  <0x140 &gic_its 0x23f8 0x8>;  
	phys = <&pcie_phy 8>;
	phy-names = "pcie-phy";
};
pcie-ss {
	compatible = "simple-bus";
	#address-cells = <1>;
	#size-cells = <1>;
	ranges = <0x0 0x0 0x40000000 0x800>;
	pcie_phy: phy@0 {
		compatible = "brcm,sr-pcie-phy";
		reg = <0x0 0x200>;
		brcm,sr-cdru = <&cdru>;
		brcm,sr-mhb = <&mhb>;
		#phy-cells = <1>;
	};
};
