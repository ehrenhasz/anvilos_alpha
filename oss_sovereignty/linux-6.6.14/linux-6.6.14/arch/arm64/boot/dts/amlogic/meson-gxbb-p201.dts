/dts-v1/;
#include "meson-gxbb-p20x.dtsi"
/ {
	compatible = "amlogic,p201", "amlogic,meson-gxbb";
	model = "Amlogic Meson GXBB P201 Development Board";
};
&ethmac {
	status = "okay";
	pinctrl-0 = <&eth_rmii_pins>;
	pinctrl-names = "default";
	phy-mode = "rmii";
	snps,reset-gpio = <&gpio GPIOZ_14 0>;
	snps,reset-delays-us = <0>, <10000>, <1000000>;
	snps,reset-active-low;
};
