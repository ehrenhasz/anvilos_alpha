/dts-v1/;
#include "meson-axg-jethome-jethub-j1xx.dtsi"
/ {
	compatible = "jethome,jethub-j110", "amlogic,a113d", "amlogic,meson-axg";
	model = "JetHome JetHub D1p (J110) Hw rev.3";
	memory@0 {
		device_type = "memory";
		reg = <0x0 0x0 0x0 0x80000000>;
	};
};
&sd_emmc_b {
	broken-cd; 
};
