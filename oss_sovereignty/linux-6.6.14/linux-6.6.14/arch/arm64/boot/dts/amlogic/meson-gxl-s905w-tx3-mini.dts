/dts-v1/;
#include "meson-gxl-s905x.dtsi"
#include "meson-gx-p23x-q20x.dtsi"
/ {
	compatible = "oranth,tx3-mini", "amlogic,s905w", "amlogic,meson-gxl";
	model = "Oranth Tanix TX3 Mini";
	memory@0 {
		device_type = "memory";
		reg = <0x0 0x0 0x0 0x40000000>;  
	};
};
&ir {
	linux,rc-map-name = "rc-tanix-tx3mini";
};
&usb {
	dr_mode = "host";
};
