/dts-v1/;
#include "meson-gxl-s905x.dtsi"
#include "meson-gx-p23x-q20x.dtsi"
/ {
	compatible = "amlogic,p281", "amlogic,s905w", "amlogic,meson-gxl";
	model = "Amlogic Meson GXL (S905W) P281 Development Board";
	memory@0 {
		device_type = "memory";
		reg = <0x0 0x0 0x0 0x40000000>;
	};
};
&usb {
	dr_mode = "host";
};
