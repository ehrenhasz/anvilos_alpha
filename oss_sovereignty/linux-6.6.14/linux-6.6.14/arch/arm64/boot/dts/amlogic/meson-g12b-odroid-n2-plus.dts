/dts-v1/;
#include "meson-g12b-a311d.dtsi"
#include "meson-g12b-odroid-n2.dtsi"
/ {
	compatible = "hardkernel,odroid-n2-plus", "amlogic,s922x", "amlogic,g12b";
	model = "Hardkernel ODROID-N2Plus";
};
&vddcpu_a {
	regulator-min-microvolt = <680000>;
	regulator-max-microvolt = <1040000>;
	pwms = <&pwm_ab 0 1500 0>;
};
&vddcpu_b {
	regulator-min-microvolt = <680000>;
	regulator-max-microvolt = <1040000>;
	pwms = <&pwm_AO_cd 1 1500 0>;
};
