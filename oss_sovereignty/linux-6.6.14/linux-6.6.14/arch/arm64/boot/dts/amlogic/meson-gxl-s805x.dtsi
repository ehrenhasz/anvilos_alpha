#include "meson-gxl-s905x.dtsi"
/ {
	compatible = "amlogic,s805x", "amlogic,meson-gxl";
};
&gpu_opp_table {
	opp-744000000 {
		status = "disabled";
	};
};
&mali {
	/delete-property/ assigned-clocks;
	/delete-property/ assigned-clock-rates;
};
