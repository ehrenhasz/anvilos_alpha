#include "alpine-v2.dtsi"
/ {
	model = "Annapurna Labs Alpine v2 EVP";
	compatible = "al,alpine-v2-evp", "al,alpine-v2";
	aliases {
		serial0 = &uart0;
		serial1 = &uart1;
		serial2 = &uart2;
		serial3 = &uart3;
	};
	chosen {
		stdout-path = "serial0:115200n8";
	};
};
&uart0 { status = "okay"; };
