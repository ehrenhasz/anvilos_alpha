#include "armada-37xx.dtsi"
/ {
	model = "Marvell Armada 3720 SoC";
	compatible = "marvell,armada3720", "marvell,armada3700";
	cpus {
		cpu1: cpu@1 {
			device_type = "cpu";
			compatible = "arm,cortex-a53";
			reg = <0x1>;
			clocks = <&nb_periph_clk 16>;
			enable-method = "psci";
		};
	};
};
