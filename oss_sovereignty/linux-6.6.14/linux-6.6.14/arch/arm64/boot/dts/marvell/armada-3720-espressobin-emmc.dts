/dts-v1/;
#include "armada-3720-espressobin.dtsi"
/ {
	model = "Globalscale Marvell ESPRESSOBin Board (eMMC)";
	compatible = "globalscale,espressobin-emmc", "globalscale,espressobin",
		     "marvell,armada3720", "marvell,armada3700";
};
&sdhci0 {
	status = "okay";
};
