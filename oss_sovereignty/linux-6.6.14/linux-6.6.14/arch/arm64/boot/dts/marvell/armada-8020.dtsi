#include "armada-ap806-dual.dtsi"
#include "armada-80x0.dtsi"
/ {
	model = "Marvell Armada 8020";
	compatible = "marvell,armada8020", "marvell,armada-ap806-dual",
		     "marvell,armada-ap806";
};
&cp0_rtc {
	status = "disabled";
};
