/dts-v1/;
#include "r9a07g044.dtsi"
/ {
	compatible = "renesas,r9a07g044c1", "renesas,r9a07g044";
	cpus {
		/delete-node/ cpu-map;
		/delete-node/ cpu@100;
	};
};
&soc {
	/delete-node/ ssi@1004a800;
	/delete-node/ serial@1004c800;
	/delete-node/ adc@10059000;
	/delete-node/ ethernet@11c30000;
};
