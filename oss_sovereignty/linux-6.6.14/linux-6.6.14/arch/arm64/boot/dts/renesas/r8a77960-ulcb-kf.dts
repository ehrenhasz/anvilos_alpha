#include "r8a77960-ulcb.dts"
#include "ulcb-kf.dtsi"
/ {
	model = "Renesas M3ULCB Kingfisher board based on r8a77960";
	compatible = "shimafuji,kingfisher", "renesas,m3ulcb",
		     "renesas,r8a7796";
};
