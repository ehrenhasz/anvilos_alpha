/dts-v1/;
#define SW_SD0_DEV_SEL	1
#define SW_SCIF_CAN	0
#if (SW_SCIF_CAN)
#define SW_RSPI_CAN	0
#else
#define SW_RSPI_CAN	1
#endif
#if (SW_SCIF_CAN && SW_RSPI_CAN)
#error "Can not set 1 to both SW_SCIF_CAN and SW_RSPI_CAN due to HW routing"
#endif
#define PMOD1_SER0	1
#define PMOD_MTU3	0
#if (PMOD_MTU3 && SW_RSPI_CAN)
#error "Cannot set as both PMOD_MTU3 and SW_RSPI_CAN are mutually exclusive"
#endif
#include "r9a07g044c2.dtsi"
#include "rzg2lc-smarc-som.dtsi"
#include "rzg2lc-smarc.dtsi"
/ {
	model = "Renesas SMARC EVK based on r9a07g044c2";
	compatible = "renesas,smarc-evk", "renesas,r9a07g044c2", "renesas,r9a07g044";
};
