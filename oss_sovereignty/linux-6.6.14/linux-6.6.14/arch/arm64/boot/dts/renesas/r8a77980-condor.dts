/dts-v1/;
#include "r8a77980.dtsi"
#include "condor-common.dtsi"
/ {
	model = "Renesas Condor board based on r8a77980";
	compatible = "renesas,condor", "renesas,r8a77980";
};
&i2c0 {
	eeprom@50 {
		compatible = "rohm,br24t01", "atmel,24c01";
		reg = <0x50>;
		pagesize = <8>;
	};
};
