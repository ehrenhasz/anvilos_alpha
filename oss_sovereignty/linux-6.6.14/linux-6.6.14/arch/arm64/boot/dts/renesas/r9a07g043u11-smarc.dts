/dts-v1/;
#define SW_SW0_DEV_SEL	1
#define SW_ET0_EN_N	1
#define PMOD_MTU3	0
#if (PMOD_MTU3 && !SW_ET0_EN_N)
#error "Cannot set as both PMOD_MTU3 and !SW_ET0_EN_N are mutually exclusive"
#endif
#include "r9a07g043u.dtsi"
#include "rzg2ul-smarc-som.dtsi"
#include "rzg2ul-smarc.dtsi"
/ {
	model = "Renesas SMARC EVK based on r9a07g043u11";
	compatible = "renesas,smarc-evk", "renesas,r9a07g043u11", "renesas,r9a07g043";
};
