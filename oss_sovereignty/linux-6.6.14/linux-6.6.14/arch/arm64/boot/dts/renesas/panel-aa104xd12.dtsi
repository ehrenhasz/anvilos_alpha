panel {
	compatible = "mitsubishi,aa104xd12", "panel-lvds";
	width-mm = <210>;
	height-mm = <158>;
	data-mapping = "jeida-18";
	panel-timing {
		clock-frequency = <65000000>;
		hactive = <1024>;
		vactive = <768>;
		hsync-len = <136>;
		hfront-porch = <20>;
		hback-porch = <160>;
		vfront-porch = <3>;
		vback-porch = <29>;
		vsync-len = <6>;
	};
	port {
	};
};
