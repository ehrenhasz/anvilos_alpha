#include "r8a779m3-ulcb.dts"
#include "ulcb-kf.dtsi"
/ {
	model = "Renesas M3ULCB Kingfisher board based on r8a779m3";
	compatible = "shimafuji,kingfisher", "renesas,m3ulcb",
		     "renesas,r8a779m3", "renesas,r8a77961";
};
