#include "r8a774a1-hihope-rzg2m-rev2.dts"
#include "hihope-rzg2-ex.dtsi"
/ {
	model = "HopeRun HiHope RZ/G2M (Rev.2.0) with sub board";
	compatible = "hoperun,hihope-rzg2-ex", "hoperun,hihope-rzg2m",
		     "renesas,r8a774a1";
};
&pciec1 {
	status = "okay";
};
