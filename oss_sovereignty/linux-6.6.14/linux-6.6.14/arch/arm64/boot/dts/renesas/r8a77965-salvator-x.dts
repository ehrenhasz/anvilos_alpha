/dts-v1/;
#include "r8a77965.dtsi"
#include "salvator-x.dtsi"
/ {
	model = "Renesas Salvator-X board based on r8a77965";
	compatible = "renesas,salvator-x", "renesas,r8a77965";
	memory@48000000 {
		device_type = "memory";
		reg = <0x0 0x48000000 0x0 0x78000000>;
	};
};
&du {
	clocks = <&cpg CPG_MOD 724>,
		 <&cpg CPG_MOD 723>,
		 <&cpg CPG_MOD 721>,
		 <&versaclock5 1>,
		 <&x21_clk>,
		 <&versaclock5 2>;
	clock-names = "du.0", "du.1", "du.3",
		      "dclkin.0", "dclkin.1", "dclkin.3";
};
