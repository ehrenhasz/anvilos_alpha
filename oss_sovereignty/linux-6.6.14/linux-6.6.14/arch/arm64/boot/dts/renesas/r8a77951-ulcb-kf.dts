#include "r8a77951-ulcb.dts"
#include "ulcb-kf.dtsi"
/ {
	model = "Renesas H3ULCB Kingfisher board based on r8a77951";
	compatible = "shimafuji,kingfisher", "renesas,h3ulcb",
		     "renesas,r8a7795";
};
