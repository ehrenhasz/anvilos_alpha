#include "r8a77965-ulcb.dts"
#include "ulcb-kf.dtsi"
/ {
	model = "Renesas M3NULCB Kingfisher board based on r8a77965";
	compatible = "shimafuji,kingfisher", "renesas,m3nulcb",
		     "renesas,r8a77965";
};
