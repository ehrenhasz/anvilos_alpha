#include "r8a779m1-ulcb.dts"
#include "ulcb-kf.dtsi"
/ {
	model = "Renesas H3ULCB Kingfisher board based on r8a779m1";
	compatible = "shimafuji,kingfisher", "renesas,h3ulcb",
		     "renesas,r8a779m1", "renesas,r8a7795";
};
