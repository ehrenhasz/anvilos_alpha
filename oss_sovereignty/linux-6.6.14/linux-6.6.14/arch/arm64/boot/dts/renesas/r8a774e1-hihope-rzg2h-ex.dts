#include "r8a774e1-hihope-rzg2h.dts"
#include "hihope-rzg2-ex.dtsi"
/ {
	model = "HopeRun HiHope RZ/G2H with sub board";
	compatible = "hoperun,hihope-rzg2-ex", "hoperun,hihope-rzg2h",
		     "renesas,r8a774e1";
};
&sata {
	status = "okay";
};
