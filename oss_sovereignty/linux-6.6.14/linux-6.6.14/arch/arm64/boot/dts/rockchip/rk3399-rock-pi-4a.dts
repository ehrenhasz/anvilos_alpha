/dts-v1/;
#include "rk3399-rock-pi-4.dtsi"
#include "rk3399-opp.dtsi"
/ {
	model = "Radxa ROCK Pi 4A";
	compatible = "radxa,rockpi4a", "radxa,rockpi4", "rockchip,rk3399";
};
&spi1 {
	status = "okay";
	flash@0 {
		compatible = "jedec,spi-nor";
		reg = <0>;
		spi-max-frequency = <10000000>;
	};
};
