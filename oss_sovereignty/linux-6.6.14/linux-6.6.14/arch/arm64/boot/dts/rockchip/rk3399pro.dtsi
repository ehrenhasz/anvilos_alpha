#include "rk3399.dtsi"
/ {
	compatible = "rockchip,rk3399pro";
};
&pcie_phy {
	status = "okay";
};
&pcie0 {
	ep-gpios = <&gpio0 RK_PB4 GPIO_ACTIVE_HIGH>;
	num-lanes = <4>;
	pinctrl-names = "default";
	pinctrl-0 = <&pcie_clkreqn_cpm>;
	status = "okay";
};
