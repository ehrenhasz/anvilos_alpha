#include "msm8996.dtsi"
/ {
	qcom,msm-id = <246 0x30000>;
};
gpu_opp_table_3_0: opp-table-gpu30 {
	compatible = "operating-points-v2";
	opp-624000000 {
		opp-hz = /bits/ 64 <624000000>;
		opp-level = <7>;
	};
	opp-560000000 {
		opp-hz = /bits/ 64 <560000000>;
		opp-level = <6>;
	};
	opp-510000000 {
		opp-hz = /bits/ 64 <510000000>;
		opp-level = <5>;
	};
	opp-401800000 {
		opp-hz = /bits/ 64 <401800000>;
		opp-level = <4>;
	};
	opp-315000000 {
		opp-hz = /bits/ 64 <315000000>;
		opp-level = <3>;
	};
	opp-214000000 {
		opp-hz = /bits/ 64 <214000000>;
		opp-level = <3>;
	};
	opp-133000000 {
		opp-hz = /bits/ 64 <133000000>;
		opp-level = <3>;
	};
};
&gpu {
	operating-points-v2 = <&gpu_opp_table_3_0>;
};
