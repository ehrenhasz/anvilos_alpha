/dts-v1/;
#include "sc7180-trogdor-wormdingler.dtsi"
/ {
	model = "Google Wormdingler rev1+ INX panel board";
	compatible = "google,wormdingler-sku0", "qcom,sc7180";
};
&panel {
	compatible = "innolux,hj110iz-01a";
};
