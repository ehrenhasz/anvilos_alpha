/dts-v1/;
#include "msm8996-sony-xperia-tone.dtsi"
/ {
	model = "Sony Xperia XZs";
	compatible = "sony,keyaki-row", "qcom,msm8996";
	chassis-type = "handset";
};
&pm8994_l19 {
	regulator-min-microvolt = <2700000>;
	regulator-max-microvolt = <2700000>;
};
&pm8994_l30 {
	regulator-min-microvolt = <2800000>;
	regulator-max-microvolt = <2800000>;
	regulator-pull-down;
};
