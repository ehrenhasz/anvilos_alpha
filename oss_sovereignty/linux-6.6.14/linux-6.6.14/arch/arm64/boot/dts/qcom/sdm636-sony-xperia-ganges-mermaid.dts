/dts-v1/;
#include "sdm630-sony-xperia-ganges-kirin.dts"
#include "sdm636.dtsi"
/ {
	model = "Sony Xperia 10 Plus";
	compatible = "sony,mermaid-row", "qcom,sdm636";
	chassis-type = "handset";
	qcom,msm-id = <345 0>;
	qcom,pmic-id = <0x1001b 0x101011a 0x00 0x00 0x1001b 0x201011a 0x00 0x00 0x1001b 0x102001a 0x00 0x00>;
};
&sdc2_state_on {
	clk-pins {
		drive-strength = <14>;
	};
};
