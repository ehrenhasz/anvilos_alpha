/dts-v1/;
#include "msm8956-sony-xperia-loire.dtsi"
/ {
	model = "Sony Xperia X Compact";
	compatible = "sony,kugo-row", "qcom,msm8956";
	chassis-type = "handset";
};
&blsp2_i2c2 {
	status = "okay";
};
&blsp2_i2c4 {
	status = "okay";
};
&pm8950_l1 {
	regulator-min-microvolt = <1100000>;
	regulator-max-microvolt = <1300000>;
};
