/dts-v1/;
#include "msm8994-sony-xperia-kitakami.dtsi"
/ {
	model = "Sony Xperia Z5 Premium";
	compatible = "sony,satsuki-row", "qcom,msm8994";
	chassis-type = "handset";
};
&pm8994_l14 {
	regulator-min-microvolt = <1850000>;
	regulator-max-microvolt = <1850000>;
};
