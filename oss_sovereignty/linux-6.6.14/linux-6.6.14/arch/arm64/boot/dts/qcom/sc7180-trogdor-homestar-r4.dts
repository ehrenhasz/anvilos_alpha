/dts-v1/;
#include "sc7180-trogdor.dtsi"
#include "sc7180-trogdor-parade-ps8640.dtsi"
#include "sc7180-trogdor-homestar.dtsi"
/ {
	model = "Google Homestar (rev4+)";
	compatible = "google,homestar", "qcom,sc7180";
};
&pp3300_brij_ps8640 {
	regulator-enable-ramp-delay = <4000>;
};
