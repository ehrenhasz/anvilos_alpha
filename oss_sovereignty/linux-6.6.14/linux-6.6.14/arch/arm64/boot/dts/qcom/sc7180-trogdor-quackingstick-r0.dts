#include "sc7180-trogdor-quackingstick.dtsi"
/ {
	model = "Google Quackingstick (rev0+)";
	compatible = "google,quackingstick-sku1537", "qcom,sc7180";
};
&mdss_dsi0_phy {
	qcom,phy-rescode-offset-top = /bits/ 8 <(-13) (-13) (-13) (-13) (-13)>;
	qcom,phy-rescode-offset-bot = /bits/ 8 <(-13) (-13) (-13) (-13) (-13)>;
	qcom,phy-drive-ldo-level = <375>;
};
&panel {
	compatible = "auo,b101uan08.3";
};
