/dts-v1/;
#include "sc7280-herobrine-zombie.dtsi"
#include "sc7280-herobrine-wifi-sku.dtsi"
#include "sc7280-herobrine-nvme-sku.dtsi"
/ {
	model = "Google Zombie with NVMe";
	compatible = "google,zombie-sku2","google,zombie-sku3","google,zombie-sku515", "qcom,sc7280";
};
