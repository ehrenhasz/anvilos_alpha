/dts-v1/;
#include "sc7180-trogdor-pompom.dtsi"
/ {
	model = "Google Pompom (rev2)";
	compatible = "google,pompom-rev2", "qcom,sc7180";
};
&charger_thermal {
	status = "disabled";
};
&pm6150_adc {
	/delete-node/ channel@4f;
};
&pm6150_adc_tm {
	/delete-node/ charger-thermistor@0;
};
