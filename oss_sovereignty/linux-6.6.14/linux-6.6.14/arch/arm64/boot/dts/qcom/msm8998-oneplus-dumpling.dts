#include "msm8998-oneplus-common.dtsi"
/ {
	model = "OnePlus 5T";
	compatible = "oneplus,dumpling", "qcom,msm8998";
	chassis-type = "handset";
	qcom,board-id = <8 0 17801 43>;
};
&framebuffer0 {
	height = <2160>;
};
&rmi4_f12 {
	touchscreen-y-mm = <137>;
};
