&ap_sar_sensor {
	label = "proximity-wifi-lte";
};
&mpss_mem {
	reg = <0x0 0x86000000 0x0 0x8c00000>;
};
&remoteproc_mpss {
	firmware-name = "qcom/sc7180-trogdor/modem/mba.mbn",
			"qcom/sc7180-trogdor/modem/qdsp6sw.mbn";
};
&ipa {
	qcom,gsi-loader = "modem";
	status = "okay";
};
