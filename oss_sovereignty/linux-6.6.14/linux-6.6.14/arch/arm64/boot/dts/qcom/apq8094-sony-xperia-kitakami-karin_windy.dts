/dts-v1/;
#include "msm8994-sony-xperia-kitakami-karin.dts"
/ {
	model = "Sony Xperia Z4 Tablet (Wi-Fi)";
	compatible = "sony,karin_windy", "qcom,apq8094";
	chassis-type = "tablet";
	qcom,msm-id = <253 0x20000>, <253 0x20001>;
};
/delete-node/ &pm8994_l1;
/delete-node/ &pm8994_l19;
