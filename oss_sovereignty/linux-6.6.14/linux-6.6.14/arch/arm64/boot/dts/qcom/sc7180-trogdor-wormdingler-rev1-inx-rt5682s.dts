/dts-v1/;
#include "sc7180-trogdor-wormdingler-rev1-inx.dts"
/ {
	model = "Google Wormdingler rev1+ (INX, rt5682s)";
	compatible = "google,wormdingler-sku1", "qcom,sc7180";
};
&alc5682 {
	compatible = "realtek,rt5682s";
	/delete-property/ VBAT-supply;
	realtek,dmic1-clk-pin = <2>;
	realtek,dmic-clk-rate-hz = <2048000>;
};
&sound {
	compatible = "google,sc7180-trogdor";
	model = "sc7180-rt5682s-max98357a-1mic";
};
