/dts-v1/;
#include "msm8916-samsung-e2015-common.dtsi"
/ {
	model = "Samsung Galaxy E7";
	compatible = "samsung,e7", "qcom,msm8916";
	chassis-type = "handset";
};
&pm8916_l17 {
	regulator-min-microvolt = <3000000>;
	regulator-max-microvolt = <3000000>;
};
