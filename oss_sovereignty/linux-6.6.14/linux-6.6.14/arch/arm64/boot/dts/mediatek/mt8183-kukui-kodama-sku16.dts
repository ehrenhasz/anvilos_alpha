/dts-v1/;
#include "mt8183-kukui-kodama.dtsi"
/ {
	model = "MediaTek kodama sku16 board";
	chassis-type = "tablet";
	compatible = "google,kodama-sku16", "google,kodama", "mediatek,mt8183";
};
&panel {
	status = "okay";
	compatible = "auo,b101uan08.3";
};
