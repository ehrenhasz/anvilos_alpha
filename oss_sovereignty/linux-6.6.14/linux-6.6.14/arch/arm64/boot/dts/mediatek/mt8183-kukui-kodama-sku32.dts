/dts-v1/;
#include "mt8183-kukui-kodama.dtsi"
/ {
	model = "MediaTek kodama sku32 board";
	compatible = "google,kodama-sku32", "google,kodama", "mediatek,mt8183";
};
&panel {
	status = "okay";
	compatible = "boe,tv101wum-n53";
};
