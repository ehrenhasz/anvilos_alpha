/dts-v1/;
#include "mt8183-kukui-krane.dtsi"
/ {
	model = "MediaTek krane sku0 board";
	chassis-type = "tablet";
	compatible = "google,krane-sku0", "google,krane", "mediatek,mt8183";
};
&panel {
	status = "okay";
	compatible = "auo,kd101n80-45na";
};
