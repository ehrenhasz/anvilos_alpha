/dts-v1/;
#include "mt8183-kukui-krane.dtsi"
/ {
	model = "MediaTek krane sku176 board";
	chassis-type = "tablet";
	compatible = "google,krane-sku176", "google,krane", "mediatek,mt8183";
};
&panel {
        status = "okay";
        compatible = "boe,tv101wum-nl6";
};
