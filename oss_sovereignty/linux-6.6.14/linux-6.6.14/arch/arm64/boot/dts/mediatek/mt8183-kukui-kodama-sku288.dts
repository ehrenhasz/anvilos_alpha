/dts-v1/;
#include "mt8183-kukui-kodama.dtsi"
/ {
	model = "MediaTek kodama sku288 board";
	chassis-type = "tablet";
	compatible = "google,kodama-sku288", "google,kodama", "mediatek,mt8183";
};
&panel {
	status = "okay";
	compatible = "boe,tv101wum-n53";
};
