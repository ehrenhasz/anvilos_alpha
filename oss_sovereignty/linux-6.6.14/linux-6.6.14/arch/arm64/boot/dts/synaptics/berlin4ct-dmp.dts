/dts-v1/;
#include "berlin4ct.dtsi"
/ {
	model = "Marvell BG4CT DMP board";
	compatible = "marvell,berlin4ct-dmp", "marvell,berlin4ct", "marvell,berlin";
	chosen {
		stdout-path = "serial0:115200n8";
	};
	memory@1000000 {
		device_type = "memory";
		reg = <0 0x01000000 0 0x7f000000>;
	};
};
&uart0 {
	status = "okay";
};
