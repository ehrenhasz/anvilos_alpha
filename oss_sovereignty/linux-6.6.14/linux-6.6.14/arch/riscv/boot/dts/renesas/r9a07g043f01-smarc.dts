/dts-v1/;
#define SW_SW0_DEV_SEL	1
#define SW_ET0_EN_N	1
#include "r9a07g043f.dtsi"
#include "rzfive-smarc-som.dtsi"
#include "rzfive-smarc.dtsi"
/ {
	model = "Renesas SMARC EVK based on r9a07g043f01";
	compatible = "renesas,smarc-evk", "renesas,r9a07g043f01", "renesas,r9a07g043";
};
