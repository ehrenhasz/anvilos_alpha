i2c@118000 {
	#address-cells = <1>;
	#size-cells = <0>;
	cell-index = <0>;
	compatible = "fsl-i2c";
	reg = <0x118000 0x100>;
	interrupts = <38 2 0 0>;
	dfsrr;
};
i2c@118100 {
	#address-cells = <1>;
	#size-cells = <0>;
	cell-index = <1>;
	compatible = "fsl-i2c";
	reg = <0x118100 0x100>;
	interrupts = <38 2 0 0>;
	dfsrr;
};
