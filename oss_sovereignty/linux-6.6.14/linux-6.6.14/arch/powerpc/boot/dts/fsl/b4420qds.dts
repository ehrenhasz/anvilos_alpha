/include/ "b4420si-pre.dtsi"
/include/ "b4qds.dtsi"
/ {
	model = "fsl,B4420QDS";
	compatible = "fsl,B4420QDS";
	ifc: localbus@ffe124000 {
		board-control@3,0 {
			compatible = "fsl,b4420qds-fpga", "fsl,fpga-qixis";
		};
	};
};
/include/ "b4420si-post.dtsi"
