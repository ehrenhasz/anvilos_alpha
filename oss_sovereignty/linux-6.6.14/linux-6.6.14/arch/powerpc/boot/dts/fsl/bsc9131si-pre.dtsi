/dts-v1/;
/include/ "e500v2_power_isa.dtsi"
/ {
	compatible = "fsl,BSC9131";
	#address-cells = <2>;
	#size-cells = <2>;
	interrupt-parent = <&mpic>;
	aliases {
		serial0 = &serial0;
		ethernet0 = &enet0;
		ethernet1 = &enet1;
	};
	cpus {
		#address-cells = <1>;
		#size-cells = <0>;
		PowerPC,BSC9131@0 {
			device_type = "cpu";
			compatible = "fsl,e500v2";
			reg = <0x0>;
			next-level-cache = <&L2>;
		};
	};
};
