mpic: pic@40000 {
	interrupt-controller;
	#address-cells = <0>;
	#interrupt-cells = <4>;
	reg = <0x40000 0x40000>;
	compatible = "fsl,mpic";
	device_type = "open-pic";
	big-endian;
	single-cpu-affinity;
	last-interrupt-source = <255>;
};
timer@41100 {
	compatible = "fsl,mpic-global-timer";
	reg = <0x41100 0x100 0x41300 4>;
	interrupts = <0 0 3 0
		      1 0 3 0
		      2 0 3 0
		      3 0 3 0>;
};
message@41400 {
	compatible = "fsl,mpic-v3.1-msgr";
	reg = <0x41400 0x200>;
	interrupts = <
		0xb0 2 0 0
		0xb1 2 0 0
		0xb2 2 0 0
		0xb3 2 0 0>;
};
msi@41600 {
	compatible = "fsl,mpic-msi";
	reg = <0x41600 0x80>;
	msi-available-ranges = <0 0x100>;
	interrupts = <
		0xe0 0 0 0
		0xe1 0 0 0
		0xe2 0 0 0
		0xe3 0 0 0
		0xe4 0 0 0
		0xe5 0 0 0
		0xe6 0 0 0
		0xe7 0 0 0>;
};
