/ {
	cpus {
		power-isa-version = "2.06";
		power-isa-b;		 
		power-isa-e;		 
		power-isa-atb;		 
		power-isa-cs;		 
		power-isa-ds;		 
		power-isa-e.ed;		 
		power-isa-e.pd;		 
		power-isa-e.hv;		 
		power-isa-e.le;		 
		power-isa-e.pm;		 
		power-isa-e.pc;		 
		power-isa-ecl;		 
		power-isa-exp;		 
		power-isa-fp;		 
		power-isa-fp.r;		 
		power-isa-mmc;		 
		power-isa-scpm;		 
		power-isa-wt;		 
		fsl,eref-deo;		 
		mmu-type = "power-embedded";
	};
};
