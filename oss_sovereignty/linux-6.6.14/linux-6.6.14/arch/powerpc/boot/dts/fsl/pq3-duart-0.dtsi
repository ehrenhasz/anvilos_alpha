serial0: serial@4500 {
	cell-index = <0>;
	device_type = "serial";
	compatible = "fsl,ns16550", "ns16550";
	reg = <0x4500 0x100>;
	clock-frequency = <0>;
	interrupts = <42 2 0 0>;
};
serial1: serial@4600 {
	cell-index = <1>;
	device_type = "serial";
	compatible = "fsl,ns16550", "ns16550";
	reg = <0x4600 0x100>;
	clock-frequency = <0>;
	interrupts = <42 2 0 0>;
};
