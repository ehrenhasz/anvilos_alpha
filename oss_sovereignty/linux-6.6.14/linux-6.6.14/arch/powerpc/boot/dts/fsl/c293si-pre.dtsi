/dts-v1/;
/include/ "e500v2_power_isa.dtsi"
/ {
	compatible = "fsl,C293";
	#address-cells = <2>;
	#size-cells = <2>;
	interrupt-parent = <&mpic>;
	aliases {
		serial0 = &serial0;
		serial1 = &serial1;
		ethernet0 = &enet0;
		ethernet1 = &enet1;
		pci0 = &pci0;
	};
	cpus {
		#address-cells = <1>;
		#size-cells = <0>;
		PowerPC,e500v2@0 {
			device_type = "cpu";
			reg = <0x0>;
			next-level-cache = <&L2>;
		};
	};
};
