/ {
	cpus {
		power-isa-version = "2.03";
		power-isa-b;		 
		power-isa-e;		 
		power-isa-atb;		 
		power-isa-cs;		 
		power-isa-e.le;		 
		power-isa-e.pm;		 
		power-isa-ecl;		 
		power-isa-mmc;		 
		power-isa-sp;		 
		power-isa-sp.fs;	 
		power-isa-sp.fv;	 
		mmu-type = "power-embedded";
	};
};
