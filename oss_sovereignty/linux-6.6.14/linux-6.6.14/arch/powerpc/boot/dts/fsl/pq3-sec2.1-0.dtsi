crypto@30000 {
	compatible = "fsl,sec2.1", "fsl,sec2.0";
	reg = <0x30000 0x10000>;
	interrupts = <45 2 0 0>;
	fsl,num-channels = <4>;
	fsl,channel-fifo-len = <24>;
	fsl,exec-units-mask = <0xfe>;
	fsl,descriptor-types-mask = <0x12b0ebf>;
};
