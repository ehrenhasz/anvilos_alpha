i2c@119000 {
	#address-cells = <1>;
	#size-cells = <0>;
	cell-index = <2>;
	compatible = "fsl-i2c";
	reg = <0x119000 0x100>;
	interrupts = <39 2 0 0>;
	dfsrr;
};
i2c@119100 {
	#address-cells = <1>;
	#size-cells = <0>;
	cell-index = <3>;
	compatible = "fsl-i2c";
	reg = <0x119100 0x100>;
	interrupts = <39 2 0 0>;
	dfsrr;
};
