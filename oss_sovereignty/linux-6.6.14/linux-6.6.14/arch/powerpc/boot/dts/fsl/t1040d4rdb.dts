/include/ "t104xsi-pre.dtsi"
/include/ "t104xd4rdb.dtsi"
/ {
	model = "fsl,T1040D4RDB";
	compatible = "fsl,T1040D4RDB";
	#address-cells = <2>;
	#size-cells = <2>;
	interrupt-parent = <&mpic>;
};
#include "t1040si-post.dtsi"
