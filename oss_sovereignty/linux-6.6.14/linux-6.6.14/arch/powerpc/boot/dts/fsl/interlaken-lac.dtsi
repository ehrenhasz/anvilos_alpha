lac: lac@229000 {
	compatible = "fsl,interlaken-lac";
	reg = <0x229000 0x1000>;
	interrupts = <16 2 1 18>;
};
lac-hv@228000 {
	compatible = "fsl,interlaken-lac-hv";
	reg = <0x228000 0x1000>;
	fsl,non-hv-node = <&lac>;
};
