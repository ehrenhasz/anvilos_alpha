/include/ "p1010si-pre.dtsi"
/ {
	model = "fsl,P1010RDB";
	compatible = "fsl,P1010RDB";
	/include/ "p1010rdb_32b.dtsi"
};
/include/ "p1010rdb.dtsi"
/include/ "p1010rdb-pa.dtsi"
/include/ "p1010si-post.dtsi"
