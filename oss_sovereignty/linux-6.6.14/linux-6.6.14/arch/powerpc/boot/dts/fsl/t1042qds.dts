/include/ "t104xsi-pre.dtsi"
/include/ "t104xqds.dtsi"
/ {
	model = "fsl,T1042QDS";
	compatible = "fsl,T1042QDS";
	#address-cells = <2>;
	#size-cells = <2>;
	interrupt-parent = <&mpic>;
};
#include "t1042si-post.dtsi"
