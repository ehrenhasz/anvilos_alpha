/include/ "t104xsi-pre.dtsi"
/include/ "t104xqds.dtsi"
/ {
	model = "fsl,T1040QDS";
	compatible = "fsl,T1040QDS";
	#address-cells = <2>;
	#size-cells = <2>;
	interrupt-parent = <&mpic>;
};
#include "t1040si-post.dtsi"
